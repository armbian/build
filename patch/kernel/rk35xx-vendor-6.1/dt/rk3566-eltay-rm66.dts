// SPDX-License-Identifier: (GPL-2.0+ OR MIT)

/* Generic RM66 with reference carrier wiring — vendor BSP 6.1 flavor. */

/dts-v1/;

#include "rk3566-eltay-rm66.dtsi"
#include "rk3566-eltay-rm66-reference-carrier.dtsi"

/ {
	model = "ELTAY RM66";
	compatible = "elron,eltay-rm66", "rockchip,rk3566";
};
