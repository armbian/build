/dts-v1/;
/plugin/;

/ {
	compatible = "radxa,zero", "amlogic,g12a";

	fragment@0 {
		target = <&i2c_AO>;
		__overlay__ {
			status = "okay";
			pinctrl-0 = <&i2c_ao_sck_pins &i2c_ao_sda_pins>;
			pinctrl-names = "default";
		};
	};
};
