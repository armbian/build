/dts-v1/;
/plugin/;

/ {
	compatible = "bananapi,bpi-m2s", "amlogic,a311d", "amlogic,g12b";

	/* RTL8822CS SDIO WIFI */
	fragment@0 {
		target = <&sd_emmc_a>;
		__overlay__ {
			status = "okay";
		};
	};

	/* RTL8822CS BLUETOOTH */
	fragment@1 {
		target = <&uart_A>;
		__overlay__ {
			status = "okay";
		};
	};
};
