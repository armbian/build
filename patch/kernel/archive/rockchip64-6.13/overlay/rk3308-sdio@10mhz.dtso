//For RockPI-S:  Increase SDIO Max Frequency from 1Mhz to 10Mhz
//Increases RTL8723-BS WiFi's throughput from 300KB/s to 2.4MB/s

/dts-v1/;
/plugin/;

/ {
	fragment@0 {
		target = <&sdio>;
		__overlay__ {
			max-frequency = <10000000>;
		};
	};
};
