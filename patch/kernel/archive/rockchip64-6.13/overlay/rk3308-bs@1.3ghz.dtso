//Overclock the Rockchip RK3308-BS suffix SOC to 1.3 Ghz
//  assumes rk3308bs-rock-pi-s.dts overlay has already been added

/dts-v1/;
/plugin/;

/ {
	fragment@0 {
		target = <&cpu0_opp_table>;
		__overlay__ {
			//the following are unsupported, overclocked operating points
			opp-1200000000 {
				opp-hz = /bits/ 64 <1200000000>;
				opp-microvolt = <1200000 1200000 1200000>;
				clock-latency-ns = <40000>;
				status = "okay";
			};
			opp-1296000000 {
				opp-hz = /bits/ 64 <1296000000>;
				opp-microvolt = <1200000 1200000 1200000>;
				clock-latency-ns = <40000>;
				status = "okay";
			};
		};
	};
};
