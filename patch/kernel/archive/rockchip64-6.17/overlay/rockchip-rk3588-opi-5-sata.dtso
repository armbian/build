/dts-v1/;
/plugin/;

/ {
	fragment@0 {
		target = <&pcie2x1l1>;

		__overlay__ {
			status = "disabled";
		};
	};

	fragment@1 {
		target = <&sata0>;

		__overlay__ {
			status = "okay";
		};
	};

	fragment@2 {
		target-path = "/regulator-vcc3v3-pcie20";
		__overlay__ {
			regulator-boot-on;
			regulator-always-on;
		};
	};
};
