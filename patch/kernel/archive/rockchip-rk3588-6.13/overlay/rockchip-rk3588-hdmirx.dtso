/dts-v1/;
/plugin/;

/ {
	fragment@0 {
		target = <&hdmi_receiver_cma>;

		__overlay__ {
			status = "okay";
		};
	};

	fragment@1 {
		target = <&hdmi_receiver>;

		__overlay__ {
			status = "okay";
		};
	};
};
