// SPDX-License-Identifier: (GPL-2.0+ OR MIT)

/dts-v1/;

#include "meson-g12b-odroid-n2-plus.dts"

/ {
	model = "Hardkernel ODROID-N2Plus with SPIDEV - MISO is pin 19, CLK is pin 23";
};

&spicc0 {
	cs-gpios = <&gpio GPIOX_10 GPIO_ACTIVE_LOW>;
	status = "okay";
	spidev@0 {
		compatible = "armbian,spi-dev";
		status = "okay";
		reg = <0>;
		spi-max-frequency = <10000000>;
	};
};

