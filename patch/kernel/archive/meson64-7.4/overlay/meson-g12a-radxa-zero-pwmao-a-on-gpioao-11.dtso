/dts-v1/;
/plugin/;

/ {
	compatible = "radxa,zero", "amlogic,g12a";

	fragment@0 {
		target = <&pwm_AO_ab>;
		__overlay__ {
			status = "okay";
			pinctrl-0 = <&pwm_ao_a_pins>;
			pinctrl-names = "default";
			clocks = <&xtal>;
			clock-names = "clkin3";
		};
	};
};
