/dts-v1/;
/plugin/;

/ {
	compatible = "radxa,zero", "amlogic,g12a";

	fragment@0 {
		target = <&i2c3>;
		__overlay__ {
			status = "okay";
			pinctrl-0 = <&i2c3_sck_a_pins &i2c3_sda_a_pins>;
			pinctrl-names = "default";
		};
	};
};
