/dts-v1/;

#include "sm8250-xiaomi-umi-common.dtsi"

/ {
	model = "Xiaomi Mi 10 (SMS)";
	compatible = "xiaomi,umi", "qcom,sm8250";
};

// &display_panel {
//     compatible = "xiaomi-umi-sms";
// 	status = "okay";
// };
