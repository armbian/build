// SPDX-License-Identifier: (GPL-2.0+ OR MIT)
/*
 * Walnut Pi 1B: Walnut Pi 1 family SBC. Micro HDMI, 100 Mbit Ethernet,
 * USB 2.0 host ports (VBUS switched via PC16), 40-pin header, status
 * LED on PC13, no eMMC.
 */

/dts-v1/;

#include "sun50i-h618-walnutpi.dtsi"

/ {
	model = "Walnut Pi 1B";
	compatible = "walnutpi,walnutpi-1b", "allwinner,sun50i-h618";

	leds {
		compatible = "gpio-leds";

		led-0 {
			function = LED_FUNCTION_STATUS;
			color = <LED_COLOR_ID_GREEN>;
			gpios = <&pio 2 13 GPIO_ACTIVE_HIGH>; /* PC13 */
			default-state = "on";
		};
	};
};

&reg_usb1_vbus {
	enable-active-high;
	gpio = <&pio 2 16 GPIO_ACTIVE_HIGH>; /* PC16 */
};
