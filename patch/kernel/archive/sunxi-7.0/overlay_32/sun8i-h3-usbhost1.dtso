/dts-v1/;
/plugin/;

/ {
	compatible = "allwinner,sun8i-h3";

	fragment@0 {
		target = <&ehci1>;
		__overlay__ {
			status = "okay";
		};
	};

	fragment@1 {
		target = <&ohci1>;
		 __overlay__ {
			status = "okay";
		};
	};

	fragment@2 {
		target = <&usbphy>;
		__overlay__ {
			status = "okay";
		};
	};
};
