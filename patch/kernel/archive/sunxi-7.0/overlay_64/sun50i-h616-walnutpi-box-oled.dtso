/dts-v1/;
/plugin/;

/*
 * Walnut Pi Box 0.96" OLED header (SSD1306, 128x64, I2C addr 0x3c) on
 * TWI2/i2c2 (PI9/PI10) — same bus as 40-pin header pins 27/28. Driven by
 * the ssd130x DRM driver; uart3 shares the PI9/PI10 pins and is disabled.
 * Enable with: overlays=walnutpi-box-oled
 */

/ {
	compatible = "walnutpi,walnutpi-box", "allwinner,sun50i-h618";

	fragment@0 {
		target = <&i2c2>;
		__overlay__ {
			#address-cells = <1>;
			#size-cells = <0>;
			pinctrl-names = "default";
			pinctrl-0 = <&i2c2_pi_pins>;
			status = "okay";

			oled: oled@3c {
				compatible = "solomon,ssd1306";
				reg = <0x3c>;
				solomon,width = <128>;
				solomon,height = <64>;
				solomon,page-offset = <0>;
				solomon,com-invdir;
			};
		};
	};

	fragment@1 {
		target = <&uart3>;
		__overlay__ {
			status = "disabled";
		};
	};
};
