/dts-v1/;
/plugin/;


/ {
	compatible = "allwinner,sun50i-h616";

	fragment@0 {
		target = <&i2c2>;
		__overlay__ {
			pinctrl-names = "default";
			pinctrl-0 = <&i2c2_pi_pins>;
			status = "okay";
		};
	};

	fragment@1 {
		target = <&uart3>;
		__overlay__ {
			status = "disabled";
		};
	};
};
