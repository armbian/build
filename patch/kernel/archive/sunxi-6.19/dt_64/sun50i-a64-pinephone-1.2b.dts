// SPDX-License-Identifier: (GPL-2.0+ OR MIT)
// Copyright (C) 2020 Ondrej Jirman <megous@megous.com>

/dts-v1/;

#include "sun50i-a64-pinephone-1.2.dts"

/ {
	model = "Pine64 PinePhone (1.2b)";
	compatible = "pine64,pinephone-1.2b", "pine64,pinephone", "allwinner,sun50i-a64";
};

&lis3mdl {
	status = "disabled";
};

&af8133j {
	status = "okay";
};
