// SPDX-License-Identifier: (GPL-2.0+ OR MIT)
/*
 * Copyright (C) 2019 OLIMEX Ltd.
 *
 */

/dts-v1/;

#include "sun50i-a64-olinuxino-1G.dts"

/ {
	model = "Olimex A64-Olinuxino-1Gs16M";
	compatible = "olimex,a64-olinuxino-1gs16m", "allwinner,sun50i-a64";

	aliases {
		spi0 = &spi0;
	};
};

&spi0 {
	status = "okay";

	spi-nor@0 {
		#address-cells = <1>;
		#size-cells = <1>;
		compatible = "winbond,w25q128", "jedec,spi-nor", "spi-flash";
		reg = <0>;
		spi-max-frequency = <10000000>;
		status = "okay";
	};
};
