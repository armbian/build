/dts-v1/;
/plugin/;

/ {
	compatible = "allwinner,sun8i-h3";

	fragment@0 {
		target = <&ir>;
		__overlay__ {
			pinctrl-names = "default";
			pinctrl-0 = <&r_ir_rx_pin>;
			status = "okay";
		};
	};
};
