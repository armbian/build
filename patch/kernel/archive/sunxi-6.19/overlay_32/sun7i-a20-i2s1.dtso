/dts-v1/;
/plugin/;

/ {
	compatible = "allwinner,sun7i-a20";

	fragment@0 {
		target = <&pio>;
		__overlay__ {
			i2s1_pins: i2s1 {
				pins = "PA9", "PA14", "PA15", "PA16", "PA17";
				function = "i2s1";
			};
		};
	};

	fragment@1 {
		target = <&i2s1>;
		__overlay__ {
			pinctrl-names = "default";
			pinctrl-0 = <&i2s1_pins>;
			status = "okay";
		};
	};
};
