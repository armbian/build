/dts-v1/;
/ {
    compatible = "allwinner,sun8i-r40";
    fragment@0 {
        target-path = "/aliases";
        __overlay__ {
            serial7 = "/soc/serial@1c29c00";
        };
    };
    fragment@1 {
        target = <0xffffffff>;
        __overlay__ {
            pinctrl-names = "default";
            pinctrl-0 = <0xffffffff>;
            status = "okay";
        };
    };
    __fixups__ {
        uart7 = "/fragment@1:target:0";
        uart7_pi_pins = "/fragment@1/__overlay__:pinctrl-0:0";
    };
};
