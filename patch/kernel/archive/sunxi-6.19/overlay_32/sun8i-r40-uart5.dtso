/dts-v1/;
/ {
    compatible = "allwinner,sun8i-r40";
    fragment@0 {
        target-path = "/aliases";
        __overlay__ {
            serial5 = "/soc/serial@1c29400";
        };
    };
    fragment@1 {
        target = <0xffffffff>;
        __overlay__ {
            pinctrl-names = "default";
            pinctrl-0 = <0xffffffff>;
            status = "okay";
        };
    };
    __fixups__ {
        uart5 = "/fragment@1:target:0";
        uart5_ph_pins = "/fragment@1/__overlay__:pinctrl-0:0";
    };
};
