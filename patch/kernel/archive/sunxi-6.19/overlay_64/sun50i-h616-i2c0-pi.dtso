/dts-v1/;
/plugin/;


/ {
	compatible = "allwinner,sun50i-h616";

	fragment@0 {
		target = <&i2c0>;
		__overlay__ {
			pinctrl-names = "default";
			pinctrl-0 = <&i2c0_pins>;
			status = "okay";
		};
	};

	fragment@1 {
		target = <&uart2>;
		__overlay__ {
			status = "disabled";
		};
	};
};
