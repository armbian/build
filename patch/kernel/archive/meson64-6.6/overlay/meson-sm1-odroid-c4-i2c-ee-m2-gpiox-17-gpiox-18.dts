/dts-v1/;
/plugin/;

/ {
	compatible = "radxa,zero", "amlogic,g12a";

	fragment@0 {
		target = <&i2c2>;
		__overlay__ {
			status = "okay";
			pinctrl-0 = <&i2c2_sck_x_pins &i2c2_sda_x_pins>;
			pinctrl-names = "default";
		};
	};
};
