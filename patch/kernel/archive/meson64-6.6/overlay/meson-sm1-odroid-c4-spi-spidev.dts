/dts-v1/;
/plugin/;

/ {
       compatible = "hardkernel,odroid-c4", "amlogic,sm1";

       fragment@0 {
               target = <&spicc0>;
               __overlay__ {
                       pinctrl-0 = <&spicc0_x_pins &spicc0_ss0_x_pins>;
                       pinctrl-names = "default";
                       status = "okay";

                       spidev@0 {
                               compatible = "armbian,spi-dev";
                               status = "okay";
                               reg = <0>;
                               spi-max-frequency = <10000000>;
                       };
               };
       };
};
