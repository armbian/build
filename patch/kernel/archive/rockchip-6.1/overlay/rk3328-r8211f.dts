/dts-v1/;
/ {
	compatible = "rockchip,rk3328";
	fragment@0 {
		target-path = "/ethernet@ff540000";
		__overlay__ {
			snps,reset-delays-us = <0 20000 100000>;
			tx_delay = <0x1a>;
			rx_delay = <0x14>;
		};
	};
	fragment@1 {
		target-path = "/ethernet@ff540000/mdio";
		__overlay__ {
			ethernet-phy@1 {
				compatible = "ethernet-phy-id001c.c916", "ethernet-phy-ieee802.3-c22";
				reset-assert-us = <20000>;
				reset-deassert-us = <100000>;
				max-speed = <1000>;
			};
		};
	};
};

