// SPDX-License-Identifier: (GPL-2.0-or-later OR MIT)
/*
 * Copyright (c) 2026 TQ-Systems GmbH <linux@ew.tq-group.com>,
 * D-82229 Seefeld, Germany.
 * Author: Martin Schmiedel
 */

/* Enables the PWM fan header (tpm6 PWM, tacho on GPIO2_IO09) on MBa93xxCA.
 * tpm6 and its supply/pinctrl are already "okay" in the base DTS; only
 * fan0 itself ships disabled.
 */

/dts-v1/;
/plugin/;

&fan0 {
	status = "okay";
};
