// SPDX-License-Identifier: (GPL-2.0-or-later OR MIT)
/*
 * Copyright (c) 2025 TQ-Systems GmbH <linux@ew.tq-group.com>,
 * D-82229 Seefeld, Germany.
 * Author: Martin Schmiedel
 */

/* MBa93xxCA shares the TQMa9352 LVDS wiring/labels with MBa93xxLA-MINI. */
#include "imx93-tqma9352-mba93xxla-mini-lvds-tm070jvhg33.dtso"
