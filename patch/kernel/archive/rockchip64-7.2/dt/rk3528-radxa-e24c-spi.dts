// SPDX-License-Identifier: (GPL-2.0+ OR MIT)
/*
 * Copyright (c) 2022 Rockchip Electronics Co., Ltd.
 * Copyright (c) 2024 Radxa Computer (Shenzhen) Co., Ltd.
 *
 */

// From https://github.com/radxa/kernel/blob/linux-6.1-stan-rkr5.1/arch/arm64/boot/dts/rockchip/rk3528-radxa-e24c-spi.dts @8582469f117fdfd5d1ab88fa7e4e15c3b714bf24

/dts-v1/;

#include "rk3528-radxa-e24c.dts"

/ {
	model = "Radxa E24C SPI";
	compatible = "radxa,e24c", "rockchip,rk3528";
};

&sfc {
	pinctrl-names = "default";
	pinctrl-0 = <&fspi_csn0>, <&fspi_pins>;
	status = "okay";

	flash@0 {
		compatible = "jedec,spi-nor";
		reg = <0>;
		spi-max-frequency = <50000000>;
		spi-rx-bus-width = <4>;
		spi-tx-bus-width = <1>;
		vcc-supply = <&vcc1v8_emmc>;
	};
};

&sdhci {
	status = "disabled";
};
