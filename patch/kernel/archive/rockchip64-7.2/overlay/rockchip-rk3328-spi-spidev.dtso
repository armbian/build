/dts-v1/;

/ {
	compatible = "rockchip,rk3328";

	fragment@0 {
		target-path = "/aliases";

		__overlay__ {
			status = "okay";
			spi0 = "/spi@ff190000";
		};
	};

	fragment@1 {
		target = <0xffffffff>;

		__overlay__ {
			status = "okay";

			spidev {
				compatible = "armbian,spi-dev";
				status = "okay";
				reg = <0x00>;
				spi-max-frequency = <0x989680>;
			};
		};
	};

	__fixups__ {
		spi0 = "/fragment@1:target:0";
	};
};
