/dts-v1/;
/plugin/;

/ {
	metadata {
		title = "Enable PWM5-M2";
		compatible = "radxa,rock-5b";
		category = "misc";
		exclusive = "GPIO4_C4";
		description = "Enable PWM5-M2.\nOn Radxa ROCK 5B this is pin 18.";
	};

	fragment@0 {
		target = <&pwm5>;

		__overlay__ {
			status = "okay";
			pinctrl-0 = <&pwm5m2_pins>;
		};
	};
};
