/dts-v1/;
/plugin/;

#include <dt-bindings/gpio/gpio.h>
#include <dt-bindings/pinctrl/rockchip.h>
#include <dt-bindings/interrupt-controller/irq.h>

/ {

	fragment@0 {
		target = <&sdio>;
		__overlay__ {
			mmc-pwrseq = <>;
			status = "disabled";
		};
	};

	fragment@1 {
		target = <&sdio_ext>;
		__overlay__ {
			mmc-pwrseq = <&sdio_pwrseq>;
			status = "okay";
		};
	};

	fragment@2 {
		target = <&sdmmc_ext>;
		__overlay__ {
			status = "disabled";
		};
	};

};
