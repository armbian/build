//WARNING this is exprimental
//
// change usb3 from host to OTG mode.
// the issue is connecting another power source to Opi 5V rail via USB3 5V.

/dts-v1/;
/plugin/;

/ {
	compatible = "xunlong,orangepi-cm5-carrier", "xunlong,orangepi-cm5", "rockchip,rk3588s";

	fragment@0 {
		target = <&usb_host0_xhci>;
		__overlay__ {
			role-switch-default-mode = "peripheral";
		};
	};
};
