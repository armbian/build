/dts-v1/;
/plugin/;

/ {
	metadata {
		title = "Enable PWM11-M1";
		compatible = "radxa,rock-5a";
		category = "misc";
		exclusive = "GPIO4_B4";
		description = "Enable PWM11-M1.\nOn Radxa ROCK 5A this is pin 15.";
	};

	fragment@0 {
		target = <&pwm11>;

		__overlay__ {
			status = "okay";
			pinctrl-0 = <&pwm11m1_pins>;
		};
	};
};
