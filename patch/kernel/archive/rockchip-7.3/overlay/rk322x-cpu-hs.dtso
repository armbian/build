/dts-v1/;
/plugin/;

&cpu0_opp_table {
	opp-1296000000 {
		opp-hz = /bits/ 64 <1296000000>;
		opp-microvolt = <1325000 1325000 1400000>;
	};
	opp-1392000000 {
		opp-hz = /bits/ 64 <1392000000>;
		opp-microvolt = <1350000 1350000 1400000>;
	};
	/*
	opp-1464000000 {
		opp-hz = /bits/ 64 <1464000000>;
		opp-microvolt = <1400000 1400000 1400000>;
	};
	*/
};
