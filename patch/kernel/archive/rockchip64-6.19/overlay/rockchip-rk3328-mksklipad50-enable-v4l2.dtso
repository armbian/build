/dts-v1/;
/plugin/;

// disable /dev/video1 + /dev/media0
&vpu {
        status = "okay";
};

// disable /dev/video2 + /dev/media1
&vdec {
        status = "okay";
};

// disable /dev/video0
&rga {
        status = "okay";
};

