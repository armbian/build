/dts-v1/;
/plugin/;

/ {
	metadata {
		title = "Enable PWM6-M0";
		compatible = "radxa,rock-5a";
		category = "misc";
		exclusive = "GPIO0_C7";
		description = "Enable PWM6-M0.\nOn Radxa ROCK 5A this is pin 27.";
	};

	fragment@0 {
		target = <&pwm6>;

		__overlay__ {
			status = "okay";
			pinctrl-0 = <&pwm6m0_pins>;
		};
	};
};
