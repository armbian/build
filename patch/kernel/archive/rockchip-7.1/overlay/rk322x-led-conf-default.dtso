/dts-v1/;
/plugin/;

#include <dt-bindings/gpio/gpio.h>
#include <dt-bindings/input/input.h>
#include <dt-bindings/pinctrl/rockchip.h>

/ {

	fragment@0 {
		target-path = "/gpio-leds";
		__overlay__ {

			working {
				gpios = <&gpio3 RK_PC5 GPIO_ACTIVE_HIGH>;
				linux,default-trigger = "none";
			};

		};
	};

};
