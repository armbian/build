/dts-v1/;
/plugin/;

/*
 * Disable regular gpio-ir-receiver and enable
 * rockchip-ir-receiver driver; also enables virtual
 * poweroff on shutdown to allow restart with power key
 * on remote controller
 */
&ir_receiver {
	status = "disabled";
};

&rockchip_ir_receiver {
	status = "okay";
};
