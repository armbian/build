/dts-v1/;
/plugin/;

/ {

	fragment@0 {
		target = <&cpu0_opp_table>;
		__overlay__ {

			opp-1296000000 {
				opp-hz = /bits/ 64 <1296000000>;
				opp-microvolt = <1325000 1325000 1400000>;
			};
			opp-1392000000 {
				opp-hz = /bits/ 64 <1392000000>;
				opp-microvolt = <1350000 1350000 1400000>;
			};
			/*
			opp-1464000000 {
				opp-hz = /bits/ 64 <1464000000>;
				opp-microvolt = <1400000 1400000 1400000>;
			};
			*/

		};
	};

};
