/dts-v1/;
/plugin/;

/ {
	compatible = "allwinner,sun50i-h616";

	fragment@0 {
		target-path = "/aliases";
		__overlay__ {
			spi1 = "/soc/spi@5011000";
		};
	};

	fragment@1 {
		target = <&spi1>;
		__overlay__ {
            status = "okay";
			#address-cells = <1>;
			#size-cells = <0>;
			spidev1_2: spidev@2 {
				compatible = "rohm,dh2228fv";
				status = "okay";
				reg = <2>;
				spi-max-frequency = <1000000>;
			};
		};
	};
};
