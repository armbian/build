/dts-v1/;
/ {
    compatible = "allwinner,sun8i-r40";
    fragment@0 {
        target-path = "/aliases";
        __overlay__ {
            spi0 = "/soc/spi@1c05000";
        };
    };
    fragment@1 {
        target = <0xffffffff>;
        __overlay__ {
            #address-cells = <0x00000001>;
            #size-cells = <0x00000000>;
            status = "okay";
            spidev@0 {
                compatible = "armbian,spi-dev";
                status = "okay";
                reg = <0x00000000>;
                spi-max-frequency = <0x000f4240>;
            };
        };
    };
    __fixups__ {
        spi0 = "/fragment@1:target:0";
    };
};
