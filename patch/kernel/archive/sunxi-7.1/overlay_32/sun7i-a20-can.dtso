/dts-v1/;
/plugin/;

/ {
	compatible = "allwinner,sun7i-a20";

	fragment@0 {
		target = <&can0>;
		__overlay__ {
			pinctrl-names = "default";
			pinctrl-0 = <&can0_pins_a>;
			status = "okay";
		};
	};
};
