/dts-v1/;
/plugin/;

/ {
	compatible = "allwinner,sun4i-a10";

	fragment@0 {
		target = <&can0>;
		__overlay__ {
			pinctrl-names = "default";
			pinctrl-0 = <&can0_ph_pins>;
			status = "okay";
		};
	};
};
