/dts-v1/;
/plugin/;

/ {
	compatible = "allwinner,sun50i-h616";

	fragment@0 {
		target = <&i2c_gpio>;
		 __overlay__ {
			status = "okay";
		};
	};

	fragment@1 {
		target = <&uart0>;
		__overlay__ {
			status = "disabled";
		};
	};
};
