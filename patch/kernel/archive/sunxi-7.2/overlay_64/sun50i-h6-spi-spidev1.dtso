// Enable the spidev interface
/dts-v1/;
/plugin/;

/ {
    compatible = "allwinner,sun8i-h3-spi";

    fragment@0 {
	target-path = "/aliases";
	__overlay__ {
            /* Path to the SPI controller nodes */
            spi1 = "/soc/spi@5011000";
        };
    };
    fragment@1 {
        target = <&spi1>;
        __overlay__ {
            pinctrl-names = "default";
            pinctrl-0 = <&spi1_pins>;
            status = "okay";
            #address-cells = <1>;
            #size-cells = <0>;
            spidev@0 {
                compatible = "armbian,spi-dev";
                reg = <0x0>;
                spi-max-frequency = <1000000>;
            };
        };
    };
};
