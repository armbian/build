/dts-v1/;
/plugin/;

/ {
	compatible = "allwinner,sun50i-h616";

	fragment@0 {
		target-path = "/aliases";
		__overlay__ {
			spi0 = "/soc/spi@5010000";
		};
	};

	fragment@1 {
		target = <&spi0>;
		__overlay__ {
            status = "okay";
			#address-cells = <1>;
			#size-cells = <0>;
			spidev0_0: spidev@0 {
				compatible = "rohm,dh2228fv";
				status = "okay";
				reg = <0>;
				spi-max-frequency = <1000000>;
			};
		};
	};
};
