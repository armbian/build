// SPDX-License-Identifier: GPL-2.0
/*
 * Avaota A1: hand the ST7789V SPI-LCD to the RISC-V E906 co-processor
 *
 * The on-board 135x240 ST7789V LCD (S_SPI0 / r_spi0 / spi@7092000) is
 * enabled in the base DT, so Linux drives it by default and exposes it as
 * /dev/fb0. Add this overlay when you want the RISC-V E906 co-processor to
 * drive the panel instead (e.g. when running custom bare-metal E906 firmware
 * from the e906-examples project).
 *
 * It just disables the r_spi0 controller: the Linux SPI driver and the fbtft
 * panel are never probed, so S_SPI0 and the PL8 (backlight), PL9 (reset) and
 * PL13 (DC) lines are left unclaimed and available to the E906.
 *
 * Enable it by adding to /boot/armbianEnv.txt:
 *
 *   overlays=avaota-a1-disable-lcd
 *
 * To go back to Linux driving the LCD, remove that line again.
 */
/dts-v1/;
/plugin/;

/ {
	compatible = "allwinner,sun55i-t527";

	fragment@0 {
		target = <&r_spi0>;
		__overlay__ {
			status = "disabled";
		};
	};
};
