/dts-v1/;
/plugin/;

/ {
	compatible = "allwinner,sun50i-h616", "allwinner,sun50i-h618";

	fragment@0 {
		target = <&pwm>;
		__overlay__ {
			status = "okay";
		};
	};

	fragment@1 {
		target = <&pwm3>;
		__overlay__ {
			status = "okay";
			pinctrl-names = "default";
			pinctrl-0 = <&pwm3_ph_pin>;
		};
	};
};
