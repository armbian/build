/dts-v1/;
/plugin/;

/ {
	compatible = "allwinner,sun7i-a20";

	fragment@0 {
		target-path = "/aliases";
		__overlay__ {
			i2c3 = "/soc@1c00000/i2c@1c2b800";
		};
	};

	fragment@1 {
		target = <&i2c3>;
		__overlay__ {
			pinctrl-names = "default";
			pinctrl-0 = <&i2c3_pins>;
			status = "okay";
		};
	};
};
