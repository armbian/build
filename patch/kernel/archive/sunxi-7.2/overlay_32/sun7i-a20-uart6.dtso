/dts-v1/;
/plugin/;

/ {
	compatible = "allwinner,sun7i-a20";

	fragment@0 {
		target-path = "/aliases";
		__overlay__ {
			serial6 = "/soc@1c00000/serial@1c29800";
		};
	};

	fragment@1 {
		target = <&uart6>;
		 __overlay__ {
			pinctrl-names = "default";
			pinctrl-0 = <&uart6_pi_pins>;
			status = "okay";
		};
	};
};
