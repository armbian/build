/dts-v1/;
/plugin/;

/ {
	compatible = "allwinner,sun7i-a20";

	fragment@0 {
		target-path = "/aliases";
		__overlay__ {
			spi2 = "/soc@1c00000/spi@1c17000";
		};
	};

	fragment@1 {
		target = <&spi2>;
		__overlay__ {
			status = "okay";
			pinctrl-names = "default", "default";
			pinctrl-0 = <&spi2_pb_pins>;
			pinctrl-1 = <&spi2_pb_cs0_pin>;
		};
	};
};
