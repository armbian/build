/dts-v1/;
/plugin/;

/ {
	compatible = "allwinner,sun7i-a20";

	fragment@0 {
		target-path = "/aliases";
		__overlay__ {
			spi0 = "/soc@1c00000/spi@1c05000";
		};
	};

	fragment@1 {
		target = <&spi0>;
		__overlay__ {
			status = "okay";
			pinctrl-names = "default", "default";
			pinctrl-0 = <&spi0_pi_pins>;
			pinctrl-1 = <&spi0_cs0_pi_pin>;
		};
	};
};
