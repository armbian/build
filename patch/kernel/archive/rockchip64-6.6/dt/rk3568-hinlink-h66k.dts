// SPDX-License-Identifier: (GPL-2.0+ OR MIT)
// Copyright (c) 2022 AmadeusGhost <amadeus@jmu.edu.cn>
// Copyright (c) 2022 Flippy <flippy@sina.com>
// Copyright (c) 2023 amazingfate <liujianfeng1994@gmail.com>

/dts-v1/;

#include "rk3568-hinlink-h68k.dts"

/ {
	model = "HINLINK H66K";
	compatible = "hinlink,h66k", "rockchip,rk3568";
};

&gmac0 {
	status = "disabled";
};

&gmac1 {
	status = "disabled";
};
