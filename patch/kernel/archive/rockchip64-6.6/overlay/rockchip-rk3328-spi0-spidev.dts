// SPDX-License-Identifier: (GPL-2.0+ OR MIT)
/*
 * Copyright (c) 2023 Thomas McKahan
 *
 */

/dts-v1/;
/plugin/;

&spi0 {
	#address-cells = <1>;
	#size-cells = <0>;
	spidev {
		compatible = "armbian,spi-dev";
		status = "disabled";
		reg = <0>;
		spi-max-frequency = <30000000>;
	};
};
