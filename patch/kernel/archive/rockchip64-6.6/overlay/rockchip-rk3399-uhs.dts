/dts-v1/;

/ {
	compatible = "rockchip,rk3399";

	fragment@0 {
		target-path = "/mmc@fe320000";

		__overlay__ {
		
			sd-uhs-sdr12;
			sd-uhs-sdr25;
			sd-uhs-sdr50;
			sd-uhs-sdr104;
			sd-uhs-ddr50;
			
		};
	};
};
