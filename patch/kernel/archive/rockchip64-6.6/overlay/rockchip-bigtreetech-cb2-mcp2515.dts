/dts-v1/;
/plugin/;

/ {
	compatible = "rockchip,rk3566";

	fragment@0 {
		target = <&spi1>;
		 __overlay__ {
			status = "okay";
		};
	};

	fragment@1 {
		target = <&can>;
		__overlay__ {
			status = "okay";
		};
	};
};
