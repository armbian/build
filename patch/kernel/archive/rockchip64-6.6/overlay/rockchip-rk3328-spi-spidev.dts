/dts-v1/;

/ {
	compatible = "rockchip,rk3328";

	fragment@0 {
		target-path = "/aliases";

		__overlay__ {
			spi0 = "/spi@ff190000";
		};
	};

	fragment@1 {
		target = <0xffffffff>;

		__overlay__ {
			#address-cells = <0x01>;
			#size-cells = <0x00>;

			spidev {
				compatible = "armbian,spi-dev";
				status = "disabled";
				reg = <0x00>;
				spi-max-frequency = <0x989680>;
			};
		};
	};

	__fixups__ {
		spi0 = "/fragment@1:target:0";
	};
};
