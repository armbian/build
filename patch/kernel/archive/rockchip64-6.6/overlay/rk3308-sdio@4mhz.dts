//For RockPI-S:  Increase SDIO Max Frequency from 1Mhz to 4Mhz
//Increases RTL8723-BS WiFi's throughput from 300KB/s to 1MB/s

/dts-v1/;
/plugin/;

/ {
	fragment@0 {
		target = <&sdio>;
		__overlay__ {
			max-frequency = <4000000>;
		};
	};
};
