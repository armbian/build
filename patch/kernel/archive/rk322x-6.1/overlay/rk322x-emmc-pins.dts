/dts-v1/;
/plugin/;

/ {

	fragment@0 {
		target = <&emmc>;
		__overlay__ {
			status = "okay";
			pinctrl-names = "default";
			pinctrl-0 = <&emmc_clk &emmc_cmd &emmc_bus8 &emmc_pwr &emmc_rst>;
		};
	};

	fragment@1 {
		target = <&nfc>;
		__overlay__ {
			status = "disabled";
		};
	};

};
