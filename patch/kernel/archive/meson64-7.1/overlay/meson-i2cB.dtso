/dts-v1/;

/ {
    compatible = "amlogic,meson-gxbb";
    fragment@0 {
        target-path = "/aliases";
        __overlay__ {
            i2cA = "/soc/bus@c1100000/i2c@87c0";
        };
    };
    fragment@1 {
	target-path = "/soc/bus@c1100000/i2c@87c0";
        __overlay__ {
            status = "okay";
        };
    };
};
