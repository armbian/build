// SPDX-License-Identifier: (GPL-2.0+ OR MIT)
/*
 * Copyright (c) 2024 JetHome
 * Author: Viacheslav Bocharov <adeep@lexina.in>
 */

/dts-v1/;

#include "meson-sm1-jethome-jethub-j200.dts"

/ {
	model = "JetHub D2 with SPI NOR flash";
};

#include "meson-g12-enable-spinor.dtsi"
