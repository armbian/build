/dts-v1/;

#include "sm8250-xiaomi-umi-common.dtsi"

/ {
	model = "Xiaomi Mi 10 (CSOT)";
	compatible = "xiaomi,umi", "qcom,sm8250";
};

// &display_panel {
//     compatible = "xiaomi-umi-csot";
// 	status = "okay";
// };
