// SPDX-License-Identifier: (GPL-2.0+ OR MIT)

/dts-v1/;

#include "rk3566-orangepi-3b.dts"

/ {
	model = "Rockchip RK3566 OPi 3B with SATA instead of PCIe";
};

&pcie2x1 {
	status = "disabled";
};

&sata2 {
	status = "okay";
};
