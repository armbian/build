/dts-v1/;
/plugin/;

/ {
	compatible = "bananapi,bpi-cm4io", "bananapi,bpi-cm4", "amlogic,a311d", "amlogic,g12b";
};

&{/} {
	model = "Waveshare CM4-IO Baseboard with BPI-CM4 Module";
};

&usb {
	dr_mode = "host";
};
