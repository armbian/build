/dts-v1/;
/plugin/;

/ {
	compatible = "radxa,zero", "amlogic,g12a";
};

&pwm_AO_ab {
	status = "okay";
	pinctrl-0 = <&pwm_ao_a_pins>;
	pinctrl-names = "default";
	clocks = <&xtal>;
	clock-names = "clkin3";
};
