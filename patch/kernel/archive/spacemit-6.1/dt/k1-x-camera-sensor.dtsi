// SPDX-License-Identifier: GPL-2.0
/*
 * Copyright (C) 2023 SPACEMIT Micro Limited
 */
#include <dt-bindings/gpio/gpio.h>
#include "k1-x_pinctrl.dtsi"

&soc {
	/* imx315 */
	backsensor: cam_sensor@0 {
		cell-index = <0>;
		twsi-index = <0>;
		dphy-index = <0>;
		compatible = "spacemit,cam-sensor";
		clocks = <&ccu CLK_CAMM0>;
		clock-names = "cam_mclk0";

		pinctrl-names = "default";
		pinctrl-0 = <&pinctrl_camera0>;
		//pwdn-gpios = <&gpio 113 GPIO_ACTIVE_HIGH>;
		//reset-gpios = <&gpio 111 GPIO_ACTIVE_HIGH>;
		//dphy-entries = <5>;
		//dphy-settings = <0x00000001 0xa2848888 0x00001500 0x000000ff 0x1001>;
		/*
		afvdd28-supply = <&ldo_12>;
		avdd28-supply = <&ldo_10>;
		dvdd12-supply = <&ldo_20>;
		iovdd18-supply = <&ldo_11>;
		cam-supply-names = "afvdd28", "avdd28", "dvdd12", "iovdd18";
		*/
		interconnects = <&dram_range1>;
		interconnect-names = "dma-mem";
		status = "okay";
	};

	/* gc2375h */
	backsensor_aux: cam_sensor@1 {
		cell-index = <1>;
		twsi-index = <1>;
		dphy-index = <2>;
		compatible = "spacemit,cam-sensor";
		clocks = <&ccu CLK_CAMM1>;
		clock-names = "cam_mclk1";
		pinctrl-names = "default";
		pinctrl-0 = <&pinctrl_camera1>;
		//dphy-entries = <5>;
		//dphy-settings = <0x00000001 0xa2848888 0x00001500 0x000000ff 0x1001>;
		//pwdn-gpios = <&gpio 114 GPIO_ACTIVE_HIGH>;
		//reset-gpios = <&gpio 112 GPIO_ACTIVE_HIGH>;
		interconnects = <&dram_range1>;
		interconnect-names = "dma-mem";
		status = "okay";
	};

	/* S5K5E3 */
	frontsensor: cam_sensor@2 {
		cell-index = <2>;
		twsi-index = <1>;
		dphy-index = <2>;
		compatible = "spacemit,cam-sensor";
		clocks = <&ccu CLK_CAMM2>;
		clock-names = "cam_mclk2";
		pinctrl-names = "default";
		pinctrl-0 = <&pinctrl_camera2>;
		//dphy-entries = <5>;
		//dphy-settings = <0x00000001 0xa2848888 0x00001500 0x000000ff 0x1001>;
		//pwdn-gpios = <&gpio 122 GPIO_ACTIVE_HIGH>;
		//reset-gpios = <&gpio 121 GPIO_ACTIVE_HIGH>;
		interconnects = <&dram_range1>;
		interconnect-names = "dma-mem";
		status = "okay";
	};
};
