// SPDX-License-Identifier: GPL-2.0
/*
 * Copyright (C) 2023 SPACEMIT Micro Limited
 */

/ {
	reserved-memory {
		#address-cells = <2>;
		#size-cells = <2>;
		ranges;

		spacemitzreserved: spacemit-mmz-@50000000 {
			no-map;
			reg = <0x0 0x50000000 0x0 0x28000000>;
		};
	};
};
