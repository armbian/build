// SPDX-License-Identifier: (GPL-2.0 OR MIT)
/* Copyright (c) 2024 Spacemit, Inc */

/dts-v1/;

#include "k1-x_deb1.dts"

/ {
	model = "BananaPi BPI-F3";
};

&uart2 {
	pinctrl-names = "default";
	pinctrl-0 = <&pinctrl_uart2>;
	status = "disabled";

	bluetooth {
		compatible = "realtek,rtl8852bs-bt";
		device-wake-gpios = <&gpio 64 GPIO_ACTIVE_HIGH>;
	};
};
