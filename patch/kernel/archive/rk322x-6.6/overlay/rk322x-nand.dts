/dts-v1/;
/plugin/;

/ {

	fragment@0 {
		target = <&nfc>;
		__overlay__ {
			status = "okay";
			pinctrl-0 = <&flash_cs0 &flash_cs1 &flash_cs2 &flash_cs3 &flash_rdy &flash_ale &flash_cle &flash_wrn &flash_bus8 &flash_dqs &flash_wp>;
			pinctrl-names = "default";
		};
	};

	fragment@1 {
		target = <&emmc>;
		__overlay__ {
			status = "disabled";
		};
	};

};
