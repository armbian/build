/* 1-Wire GPIO
*  From ASUS: https://github.com/TinkerBoard/debian_kernel/blob/develop/arch/arm/boot/dts/overlays/w1-gpio-overlay.dts
*
*
*/

/dts-v1/;
/plugin/;

/ {
    compatible = "rockchip,rk3288";
};

&{/} {
    w1: onewire@0 {
        compatible = "w1-gpio";
        pinctrl-names = "default";
        gpios = <&gpio0 17 0>;
        status = "okay";
    };
};
