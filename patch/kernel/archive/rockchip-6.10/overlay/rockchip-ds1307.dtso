/* 	Definitions for ds1307
*	From ASUS: https://github.com/TinkerBoard/debian_kernel/commits/develop/arch/arm/boot/dts/overlays/ds1307-overlay.dts
*/

/dts-v1/;
/plugin/;

/ {
	compatible = "rockchip,rk3288";

	fragment@0 {
		target = <&i2c1>;
		__overlay__ {
			#address-cells = <1>;
			#size-cells = <0>;
			rtc: ds1307@68 {
				compatible = "dallas,ds1307";
				reg = <0x68>;
				status = "okay";
			};
		};
	};
};
