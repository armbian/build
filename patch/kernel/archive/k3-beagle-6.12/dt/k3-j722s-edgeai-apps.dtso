// SPDX-License-Identifier: GPL-2.0
/*
 * J722S EdgeAI device-tree overlay
 *
 * Memory ABI from Texas Instruments PSDK Analytics 11.02.01.
 */

/dts-v1/;
/plugin/;

#include "k3-j722s-rtos-memory-map.dtsi"
