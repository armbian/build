/dts-v1/;
/plugin/;

/*
 * Run the H616 USB0 (musb, PHY0) port as a USB host instead of the default
 * peripheral/OTG role.
 *
 * On the Orange Pi Zero2 / Zero3 PHY0 is wired to the USB-C socket, which
 * normally powers the board (both CC pins pulled to GND, no role switch), so
 * the mainline DTS keeps it in peripheral mode. When the board is powered
 * through the GPIO header instead, the USB-C port can act as a host with an
 * adapter/cable that ignores CC; this overlay does what the DTSI comment
 * describes for that case: dr_mode = "host" and EHCI0/OHCI0 enabled.
 *
 * Usage: overlays=usb-otg-host in /boot/armbianEnv.txt
 */

/ {
	compatible = "allwinner,sun50i-h616", "allwinner,sun50i-h618";

	fragment@0 {
		target = <&usbotg>;
		__overlay__ {
			dr_mode = "host";
			status = "okay";
		};
	};

	fragment@1 {
		target = <&ehci0>;
		__overlay__ {
			status = "okay";
		};
	};

	fragment@2 {
		target = <&ohci0>;
		__overlay__ {
			status = "okay";
		};
	};
};
