/dts-v1/;
/plugin/;

/ {
	compatible = "sinovoip,bpi-m4-zero", "allwinner,sun50i-h616", "allwinner,sun50i-h618";

	fragment@0 {
		target = <&uart1>;
		__overlay__ {
			status = "okay";
			pinctrl-0 = <&uart1_pins>, <&uart1_rts_cts_pins>;
			pinctrl-names = "default";
			uart-has-rtscts;
		};
	};
};
