// SPDX-License-Identifier: GPL-2.0
/*
 * Enable the Vivante NPU on T527 boards whose base DT keeps it disabled,
 * such as the industrial Radxa Cubie A5E. The A527 has no NPU.
 */
/dts-v1/;
/plugin/;

/ {
	compatible = "allwinner,sun55i-t527";

	fragment@0 {
		target = <&npu>;
		__overlay__ {
			status = "okay";
		};
	};
};
