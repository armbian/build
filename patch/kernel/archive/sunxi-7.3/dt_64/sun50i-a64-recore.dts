// SPDX-License-Identifier: (GPL-2.0+ OR MIT)

/dts-v1/;

#include "sun50i-a64-recore.dtsi"

/ {
	model = "Recore-all";
	compatible = "iagent,recore-all", "allwinner,sun50i-a64";

	reg_usb1_vbus5: usb1-vbus5 {
		compatible = "regulator-fixed";
		regulator-name = "usb1-vbus5";
		gpio = <&pio 3 5 GPIO_ACTIVE_HIGH>; /* PD5 */
		regulator-min-microvolt = <5000000>;
		regulator-max-microvolt = <5000000>;
		regulator-always-on;
		enable-active-high;
		vin-supply = <&reg_5v>;
	};
	reg_usb1_vbus6: usb1-vbus6 {
		compatible = "regulator-fixed";
		regulator-name = "usb1-vbus6";
		gpio = <&pio 3 6 GPIO_ACTIVE_HIGH>; /* PD6 */
		regulator-min-microvolt = <5000000>;
		regulator-max-microvolt = <5000000>;
		regulator-always-on;
		enable-active-high;
		vin-supply = <&reg_5v>;
	};
};

&mali {
	/delete-property/ operating-points-v2;
	assigned-clock-rates = <120000000>;
};
