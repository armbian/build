// SPDX-License-Identifier: (GPL-2.0+ OR MIT)
/*
 * Copyright (c) 2026 Patrick Yavitz <pyavitz@gmail.com>
 */

/dts-v1/;

#include "sun50i-h618-bananapi-m4.dtsi"

/ {
	model = "BananaPi BPI-M4-Zero";
};
