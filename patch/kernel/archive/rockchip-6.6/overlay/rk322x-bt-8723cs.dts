/dts-v1/;
/plugin/;

#include <dt-bindings/gpio/gpio.h>
#include <dt-bindings/input/input.h>
#include <dt-bindings/pinctrl/rockchip.h>

&uart1 {
    pinctrl-0 = <&uart11_xfer>, <&uart11_rts>, <&uart11_cts>;
    pinctrl-names = "default";
    uart-has-rtscts;
    status = "okay";
    bluetooth {
        compatible = "realtek,rtl8723cs-bt";
        enable-gpios = <&gpio2 RK_PD5 GPIO_ACTIVE_HIGH>;
        device-wake-gpios = <&gpio3 RK_PD3 GPIO_ACTIVE_HIGH>;
        host-wake-gpios = <&gpio3 RK_PD2 GPIO_ACTIVE_HIGH>;
    };
};
