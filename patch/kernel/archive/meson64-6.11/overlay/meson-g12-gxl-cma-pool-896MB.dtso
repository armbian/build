/dts-v1/;
/plugin/;

/ {
	compatible = "amlogic,g12a", "amlogic,g12b", "amlogic,meson-gxl";

	fragment@0 {
		target-path = "/reserved-memory";
		__overlay__ {
			linux,cma {
				compatible = "shared-dma-pool";
				reusable;
				size = <0x0 0x38000000>;
				alignment = <0x0 0x400000>;
				linux,cma-default;
			};
		};
	};
};
