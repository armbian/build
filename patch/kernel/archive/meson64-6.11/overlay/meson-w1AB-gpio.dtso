// Definitions for w1-gpio module (without external pullup)
/dts-v1/;
/plugin/;

/ {
	compatible = "amlogic,meson-gxbb";

	fragment@0 {
		target-path = "/";
		__overlay__ {

			w1a: onewire@0 {
				compatible = "w1-gpio";
				pinctrl-names = "default";
				gpios = <&gpio 91 6>; // GPIOY_16
				status = "okay";
			};
		};
	};
	fragment@1 {
		target-path = "/";
		__overlay__ {

			w1b: onewire@1 {
				compatible = "w1-gpio";
				pinctrl-names = "default";
				gpios = <&gpio 90 6>; // GPIOY_15
				status = "okay";
			};
		};
	};
};
