// SPDX-License-Identifier: (GPL-2.0+ OR MIT)

/dts-v1/;

#include "meson-g12b-odroid-n2-plus.dts"

/ {
	model = "Hardkernel ODROID-N2Plus with SPI NOR flash";
};

#include "meson-g12-enable-spinor.dtsi"
