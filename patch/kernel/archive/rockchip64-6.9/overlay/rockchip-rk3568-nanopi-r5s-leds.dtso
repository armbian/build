/dts-v1/;
/plugin/;


&{/gpio-leds/led-wan} {
        linux,default-trigger = "stmmac-0:01:link";
};

&{/gpio-leds/led-lan1} {
        linux,default-trigger = "r8169-0-100:00:link";
};

&{/gpio-leds/led-lan2} {
        linux,default-trigger = "r8169-1-100:00:link";
};
