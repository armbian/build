/dts-v1/;
/plugin/;

/ {
	compatible = "radxa,zero", "amlogic,g12a";

	fragment@0 {
		target = <&uart_AO>;
		__overlay__ {
			status = "okay";
			pinctrl-0 = <&uart_ao_a_pins>;
			pinctrl-names = "default";
		};
	};
};
