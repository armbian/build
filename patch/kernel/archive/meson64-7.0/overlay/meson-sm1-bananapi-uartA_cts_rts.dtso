/dts-v1/;
/plugin/;

/ {
	compatible = "bananapi,bpi-m5", "bananapi,bpi-m2-pro", "amlogic,sm1";

	fragment@0 {
		target = <&uart_A>;

		__overlay__ {
			status = "okay";
			pinctrl-names = "default";
			pinctrl-0 = <&uart_a_cts_rts_pins>;
		};
	};
};

