/dts-v1/;
/plugin/;

/ {
	compatible = "bananapi,bpi-cm4io", "bananapi,bpi-cm4", "amlogic,a311d", "amlogic,g12b";

	fragment@0 {
		target-path = "/";
		__overlay__ {
			model = "Waveshare CM4-IO Baseboard with BPI-CM4 Module";
		};
	};
	
	fragment@1 {
		target = <&usb>;
		__overlay__ {
			dr_mode = "host";
		};
	};
};
