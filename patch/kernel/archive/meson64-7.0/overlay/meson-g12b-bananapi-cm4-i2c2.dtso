/dts-v1/;
/plugin/;

/ {
	compatible = "bananapi,bpi-cm4io", "bananapi,bpi-cm4", "amlogic,a311d", "amlogic,g12b";

	fragment@0 {
		target = <&i2c2>;
		__overlay__ {
			status = "okay";
		};
	};

	fragment@1 {
		target = <&uart_A>;
		__overlay__ {
			status = "disabled";
		};
	};
};
