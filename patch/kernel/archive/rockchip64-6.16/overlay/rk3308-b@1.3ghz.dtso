//Overclock the Rockchip RK3308-B suffix SOC to 1.3 Ghz
//  THIS SHOULD NOT BE APPLIED to RK3308-B-S suffix chips
//  because is will overvolt them

/dts-v1/;
/plugin/;

/ {
	fragment@0 {
		target = <&cpu0_opp_table>;
		__overlay__ {
			//the following are unsupported, overclocked operating points
			opp-1200000000 {
				opp-hz = /bits/ 64 <1200000000>;
				opp-microvolt = <1250000 1250000 1340000>;
				clock-latency-ns = <40000>;
				status = "okay";
			};
			opp-1296000000 {
				opp-hz = /bits/ 64 <1296000000>;
				opp-microvolt = <1300000 1300000 1340000>;
				clock-latency-ns = <40000>;
				status = "okay";
			};
		};
	};
};
