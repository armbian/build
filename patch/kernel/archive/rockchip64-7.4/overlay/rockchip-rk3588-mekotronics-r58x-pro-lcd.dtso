// SPDX-License-Identifier: (GPL-2.0+ OR MIT)
/*
 * Mekotronics R58X-Pro: front panel segment LCD (Vinka VK2C21),
 * bit-banged on GPIO0_C4 (SDA) / GPIO0_C5 (SCL).
 * Needs the Armbian vinka,vk2c21 auxdisplay driver.
 */

/dts-v1/;
/plugin/;

#include <dt-bindings/gpio/gpio.h>
#include <dt-bindings/pinctrl/rockchip.h>

/ {
	compatible = "mekotronics,r58x-pro";
};

&{/} {
	segment-lcd {
		compatible = "vinka,vk2c21";
		sda-gpios = <&gpio0 RK_PC4 GPIO_ACTIVE_HIGH>;
		scl-gpios = <&gpio0 RK_PC5 GPIO_ACTIVE_HIGH>;
		clock-frequency = <100000>;
	};
};
