//For RockPI 4C+:  Change the top USB3.0 port to host mode

/dts-v1/;
/plugin/;

/ {
	compatible = "radxa,rockpi4c-plus", "radxa,rockpi4", "rockchip,rk3399";
};

&usbdrd_dwc3_0 {
	dr_mode = "host";
};
