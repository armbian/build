// SPDX-License-Identifier: (GPL-2.0+ OR MIT)

/dts-v1/;

#include "rk3576-armsom-sige5.dts"

/ {
	model = "Banana Pi M5 Pro";
	compatible = "bananapi,m5-pro", "rockchip,rk3576";
};

&uart4 {
	pinctrl-names = "default";
	pinctrl-0 = <&uart4m1_xfer
		     &uart4m1_ctsn
		     &uart4m1_rtsn>;

	uart-has-rtscts;
	status = "okay";

	bluetooth {
		compatible = "realtek,rtl8822cs-bt";
		enable-gpios = <&gpio1 RK_PC7 GPIO_ACTIVE_HIGH>;
		device-wake-gpios = <&gpio1 RK_PD4 GPIO_ACTIVE_HIGH>;
		host-wake-gpios = <&gpio0 RK_PB1 GPIO_ACTIVE_HIGH>;
		pinctrl-names = "default";
		pinctrl-0 = <&bt_reg_on &host_wake_bt &bt_wake_host>;
	};
};
