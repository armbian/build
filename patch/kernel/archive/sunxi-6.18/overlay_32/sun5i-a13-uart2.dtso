/dts-v1/;
/plugin/;

/ {
	compatible = "allwinner,sun5i-a13";

	fragment@0 {
		target-path = "/aliases";
		__overlay__ {
			uart2 = "/soc@1c00000/serial@1c28800";
		};
	};

	fragment@1 {
		target = <&uart2>;
		 __overlay__ {
			pinctrl-names = "default";
			pinctrl-0 = <&uart2_pd_pins>;
			status = "okay";
		};
	};
};
