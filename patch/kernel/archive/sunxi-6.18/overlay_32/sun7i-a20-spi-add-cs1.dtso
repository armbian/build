/dts-v1/;
/plugin/;

/ {
	compatible = "allwinner,sun7i-a20";

	fragment@0 {
		target = <&spi0>;
		__overlay__ {
			pinctrl-names = "default", "default", "default";
			pinctrl-0 = <&spi0_pi_pins>;
			pinctrl-1 = <&spi0_cs0_pi_pin>;
			pinctrl-2 = <&spi0_cs1_pi_pin>;
		};
	};
};
