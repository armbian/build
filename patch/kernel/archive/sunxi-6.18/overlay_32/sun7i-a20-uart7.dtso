/dts-v1/;
/plugin/;

/ {
	compatible = "allwinner,sun7i-a20";

	fragment@0 {
		target-path = "/aliases";
		__overlay__ {
			serial7 = "/soc@1c00000/serial@1c29c00";
		};
	};

	fragment@1 {
		target = <&uart7>;
		 __overlay__ {
			pinctrl-names = "default";
			pinctrl-0 = <&uart7_pi_pins>;
			status = "okay";
		};
	};
};
