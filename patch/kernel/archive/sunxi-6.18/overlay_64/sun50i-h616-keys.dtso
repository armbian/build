/dts-v1/;
/plugin/;

/ {
	compatible = "xunlong,orangepi-zero2w", "allwinner,sun50i-h616", "allwinner,sun50i-h618";

	fragment@0 {
		target = <&lradc>;
		__overlay__ {
			vref-supply = <&reg_aldo1>;
			status = "okay";

			button-500 {
				label = "KEY_VOLUMEUP";
				linux,code = <115>;    // KEY_VOLUMEUP
				channel = <0>;
				voltage = <500000>;
			};

			button-800 {
				label = "KEY_VOLUMEDOWN";
				linux,code = <114>; // KEY_VOLUMEDOWN
				channel = <0>;
				voltage = <800000>;
			};
		};
	};
};
