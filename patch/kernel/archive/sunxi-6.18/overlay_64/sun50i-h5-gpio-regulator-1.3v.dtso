/dts-v1/;
/plugin/;

/ {
	compatible = "allwinner,sun50i-h5";

	fragment@0 {
		target-path = "/";

		__overlay__ {
			reg_vdd_cpux: gpio-regulator {
				compatible = "regulator-gpio";
				regulator-name = "vdd-cpux";
				regulator-type = "voltage";
				regulator-boot-on;
				regulator-always-on;
				regulator-min-microvolt = <1100000>;
				regulator-max-microvolt = <1300000>;
				regulator-ramp-delay = <50>; /* 4ms */

				gpios = <&r_pio 0 6 0>; /* PL6 */
				enable-active-high;
				gpios-states = <0x1>;
				states = <1100000 0x0
					  1300000 0x1>;
			};
		};
	};

	fragment@1 {
		target = <&cpu0>;

		__overlay__ {
			cpu-supply = <&reg_vdd_cpux>;
		};
	};
};

