/dts-v1/;
/plugin/;

/ {
	fragment@0 {
		target = <&i2c_gpio>;
		 __overlay__ {
			status = "okay";
		};
	};

    fragment@1 {
		target = <&spi1>;
		 __overlay__ {
			status = "okay";
		};
	};

    fragment@2 {
		target = <&tft_35>;
		__overlay__ {
            status = "okay";
            spi-max-frequency = <12500000>;
		};
	};

    fragment@3 {
		target = <&tft_tp>;
		__overlay__ {
            status = "okay";
		};
	};
};
