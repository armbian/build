// DT overlay for CPU frequency operating points to up to 1.0GHz at a maximum CPU voltage of 1.1v

/dts-v1/;
/plugin/;

/ {
	fragment@0 {
		target = <&cpu_opp_table>;

		__overlay__ {
			compatible = "operating-points-v2";
			opp-shared;

			// in order to match the H5 DT cooling-maps, update the existing OP table in-place
			// with the new voltages

			opp-960000000 {
				opp-hz = /bits/ 64 <960000000>;
				opp-microvolt = <1100000 1100000 1300000>;
				clock-latency-ns = <244144>; /* 8 32k periods */
			};

			opp-1008000000 {
				opp-hz = /bits/ 64 <1008000000>;
				opp-microvolt = <1100000 1100000 1300000>;
				clock-latency-ns = <244144>; /* 8 32k periods */
			};
		};
	};
};

