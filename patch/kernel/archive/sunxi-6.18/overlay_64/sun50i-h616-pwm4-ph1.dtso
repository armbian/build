/dts-v1/;
/plugin/;

/ {
	compatible = "allwinner,sun50i-h616", "allwinner,sun50i-h618";

	fragment@0 {
		target = <&pwm>;
		__overlay__ {
			status = "okay";
		};
	};

	fragment@1 {
		target = <&pwm4>;
		__overlay__ {
			status = "okay";
			pinctrl-names = "default";
			pinctrl-0 = <&pwm4_ph_pin>;
		};
	};

	/* PH0/PH1 are UART0 TX/RX (the debug console): free them for the PWM */
	fragment@2 {
		target = <&uart0>;
		__overlay__ {
			status = "disabled";
		};
	};
};
