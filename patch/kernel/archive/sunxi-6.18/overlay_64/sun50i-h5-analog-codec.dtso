/dts-v1/;
/plugin/;

/ {
	compatible = "allwinner,sun50i-h5";

	fragment@0 {
		target = <&codec>;
		__overlay__ {
			allwinner,audio-routing =
				"Line Out", "LINEOUT",
				"MIC1", "Mic",
				"Mic",  "MBIAS";
			status = "okay";
		};
	};
};
