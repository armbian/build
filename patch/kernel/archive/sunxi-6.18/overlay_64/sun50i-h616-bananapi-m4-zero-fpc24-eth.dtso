/dts-v1/;
/plugin/;

/ {
        compatible = "sinovoip,bpi-m4-zero", "allwinner,sun50i-h616", "allwinner,sun50i-h618";

        /* PWM5 provides the 2MHz reference clock for the AC300 EPHY */
        fragment@0 {
                target = <&pwm>;
                __overlay__ {
                        status = "okay";
                };
        };

        fragment@1 {
                target = <&pwm5>;
                __overlay__ {
                        pinctrl-names = "default";
                        pinctrl-0 = <&pwm5_pin>;
                        clk_bypass_output = <0x1>;
                        status = "okay";
                };
        };

        /* Fast Ethernet, only reachable through the 24-pin FPC connector */
        fragment@2 {
                target = <&emac1>;
                __overlay__ {
                        status = "okay";
                };
        };
};
