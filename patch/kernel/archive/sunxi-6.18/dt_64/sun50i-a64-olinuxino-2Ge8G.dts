// SPDX-License-Identifier: (GPL-2.0+ OR MIT)
/*
 * Copyright (C) 2019 OLIMEX Ltd.
 *
 */

/dts-v1/;

#include "sun50i-a64-olinuxino-1G.dts"

/ {
	model = "Olimex A64-Olinuxino-2Ge8G-IND";
	compatible = "olimex,a64-olinuxino-2ge8g", "allwinner,sun50i-a64";
};

&mmc2 {
	pinctrl-names = "default";
	pinctrl-0 = <&mmc2_pins>;
	vmmc-supply = <&reg_dcdc1>;
	vqmmc-supply = <&reg_dcdc1>;
	bus-width = <8>;
	non-removable;
	cap-mmc-hw-reset;
	status = "okay";
};
