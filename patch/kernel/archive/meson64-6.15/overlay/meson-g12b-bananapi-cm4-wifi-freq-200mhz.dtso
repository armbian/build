/dts-v1/;
/plugin/;

/ {
	compatible = "bananapi,bpi-cm4io", "bananapi,bpi-cm4", "amlogic,a311d", "amlogic,g12b";

	fragment@0 {
		target-path = "/";
		__overlay__ {
			sdio-pwrseq {
				post-power-on-delay-ms = <200>;
			};
		};
	};

	fragment@1 {
		target = <&sd_emmc_a>;
		__overlay__ {
			max-frequency = <200000000>;
		};
	};
};
