// SPDX-License-Identifier: (GPL-2.0+ OR MIT)
/*
 * The ArmSoM Sige7s is a rebranded CoolPi 4B. ArmSoM acquired the original
 * hardware design and confirmed that it was not modified. Reuse the CoolPi
 * 4B description while keeping the Sige7s model and compatible to identify
 * the board under its marketed name.
 */

/dts-v1/;

#include "rk3588s-coolpi-4b.dts"

/ {
	model = "ArmSoM Sige7s";
	compatible = "armsom,sige7s", "coolpi,pi-4b", "rockchip,rk3588s";
};
