/dts-v1/;
/plugin/;

/ {
	metadata {
		title = "Enable PWM15-M3";
		compatible = "radxa,rock-5a", "radxa,rock-5b";
		category = "misc";
		exclusive = "GPIO1_D7";
		description = "Enable PWM15-M3.\nOn Radxa ROCK 5A this is pin 3.\nOn Radxa ROCK 5B this is pin 29.";
	};

	fragment@0 {
		target = <&pwm15>;

		__overlay__ {
			status = "okay";
			pinctrl-0 = <&pwm15m3_pins>;
		};
	};
};
