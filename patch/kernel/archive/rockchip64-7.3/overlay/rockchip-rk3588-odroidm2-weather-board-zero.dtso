/dts-v1/;
/plugin/;

/ {
	compatible = "hardkernel,odroid-m2", "rockchip,rk3588s";

	fragment@0 {
		target = <&i2c5>;

		__overlay__ {
			status = "okay";
			pinctrl-0 = <&i2c5m2_xfer>;
			#address-cells = <1>;
			#size-cells = <0>;

			weather_sensor: shtc1@70 {
				status = "okay";
				label = "weather_board_zero";
				compatible = "sensirion,shtc1";
				reg = <0x70>;
			};
		};
	};
};
