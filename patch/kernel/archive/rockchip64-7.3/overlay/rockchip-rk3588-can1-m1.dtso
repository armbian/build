/dts-v1/;
/plugin/;

#include <dt-bindings/clock/rockchip,rk3588-cru.h>

&can1 {
	assigned-clocks = <&cru CLK_CAN1>;
	assigned-clock-rates = <300000000>;
	status = "okay";
	pinctrl-0 = <&can1m1_pins>;
};
