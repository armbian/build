/dts-v1/;

/ {
	compatible = "rockchip,rk3328";

	fragment@0 {
	target-path = "/spi@ff190000";

		__overlay__ {
			spi_for_lcd@0 {
				status = "disabled";
			};
			spi_for_touch@1 {
				status = "disabled";
			};
		};
	};

	fragment@1 {
		target = <0xffffffff>;

		__overlay__ {
			status = "okay";
		};
	};

	__fixups__ {
		uart1 = "/fragment@1:target:0";
	};
};
