/dts-v1/;
/plugin/;

/ {
	metadata {
		title = "Enable PWM8-M0";
		compatible = "radxa,rock-5b";
		category = "misc";
		exclusive = "GPIO3_A7";
		description = "Enable PWM8-M0.\nOn Radxa ROCK 5B this is pin 33.";
	};

	fragment@0 {
		target = <&pwm8>;

		__overlay__ {
			status = "okay";
			pinctrl-0 = <&pwm8m0_pins>;
		};
	};
};
