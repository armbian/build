// SPDX-License-Identifier: (GPL-2.0+ OR MIT)
/*
 * Add a 1992 MHz CPU OPP at 1.2 V for RK3566.
 * If the board limits vdd_cpu below 1.2 V, the OPP falls back to about 1.15 V.
 * On RK3568 it raises the stock 1992 MHz OPP to 1.2 V if the board allows it.
 */
/dts-v1/;
/plugin/;

/ {
	fragment@0 {
		target = <&cpu0_opp_table>;

		__overlay__ {
			opp-1992000000 {
				opp-hz = /bits/ 64 <1992000000>;
				opp-microvolt = <1200000 1150000 1200000>;
				clock-latency-ns = <40000>;
			};
		};
	};
};
