/dts-v1/;
/plugin/;

/ {
	metadata {
		title = "Enable USB-C PD";
		compatible = "radxa,rock-5b";
		description = "Enable power-delivery messages over USB-C.\nThis may cause boot looping.\nIf this overlay is not enabled, USB PD negotiation will not be tried.";
	};

	fragment@0 {
		target-path = "/i2c@feac0000/usb-typec@22";
		__overlay__ {
			status = "okay";
		};
	};
};
