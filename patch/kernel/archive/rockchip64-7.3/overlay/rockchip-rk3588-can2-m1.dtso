/dts-v1/;
/plugin/;

#include <dt-bindings/clock/rockchip,rk3588-cru.h>

&can2 {
	assigned-clocks = <&cru CLK_CAN2>;
	assigned-clock-rates = <300000000>;
	status = "okay";
	pinctrl-0 = <&can2m1_pins>;
};
