/dts-v1/;
/plugin/;

/ {
	fragment@0 {
		target = <&spi3>;

		__overlay__ {
			status = "okay";

			spidev@0 {
				compatible = "armbian,spi-dev";
				status = "okay";
				reg = <0>;
				spi-max-frequency = <50000000>;
			};
		};
	};
};
