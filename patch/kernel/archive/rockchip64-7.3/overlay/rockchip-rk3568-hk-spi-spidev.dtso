/dts-v1/;
/plugin/;

/ {
	fragment@0 {
		target = <&spi0>;

		__overlay__ {
			status = "okay";
			#address-cells = <1>;
			#size-cells = <0>;

			spidev: spidev@0 {
				status = "okay";
				compatible = "armbian,spi-dev";
				reg = <0>;
				/* spi default max clock 100Mhz */
				spi-max-frequency = <100000000>;
			};
		};
	};
};
