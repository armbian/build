/dts-v1/;
/plugin/;

/ {
	compatible = "radxa,zero", "amlogic,g12a";

	fragment@0 {
		target = <&uart_AO_B>;
		__overlay__ {
			status = "okay";
			pinctrl-0 = <&uart_ao_b_8_9_pins>;
			pinctrl-names = "default";
		};
	};
};
