/dts-v1/;
/plugin/;

/ {
	/* Banana Pi M2S/M5 */
	compatible = "bananapi,bpi-m2s", "bananapi,bpi-m5";

	/* RTL8822CS SDIO WIFI */
	fragment@0 {
		target = <&sd_emmc_a>;
		__overlay__ {
			status = "okay";
		};
	};

	/* RTL8822CS BLUETOOTH */
	fragment@1 {
		target = <&uart_A>;
		__overlay__ {
			status = "okay";
		};
	};
};
