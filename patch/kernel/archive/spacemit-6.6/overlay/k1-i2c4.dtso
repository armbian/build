/dts-v1/;
/plugin/;

// For Orange Pi RV2, but may work on other devices. Origin:
// https://github.com/orangepi-xunlong/linux-orangepi/tree/orange-pi-6.6-ky/arch/riscv/boot/dts/ky/overlay

/ {
	compatible = "spacemit,k1-x";
};

&i2c4 {
	status = "okay";
};
