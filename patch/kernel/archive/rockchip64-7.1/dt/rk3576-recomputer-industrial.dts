// SPDX-License-Identifier: (GPL-2.0+ OR MIT)
/*
 * Seeed Studio reComputer Industrial RK3576 — early mainline kernel DT.
 *
 * Difference-only overlay on top of the reComputer RK3576 Dev Kit DT: both
 * boards share the same RK3576 SoM (eMMC, RK806 PMIC, RTL8211F on GMAC0,
 * USB, PCIe, HDMI). Carrier differences applied here:
 *   - no SD slot: eMMC (sdhci) is the only boot medium, mmc0 alias remapped
 *   - no volume-up adc key circuit on the carrier (avoid floating SARADC
 *     triggering the key) — node removed
 *   - GMAC1 PHY on the carrier is a Maxio MAE0621A (no mainline driver);
 *     left enabled, networking on GMAC1 simply won't come up
 * Not covered on mainline (vendor-only for now): WQ9201S WiFi/BT, CAN1,
 * PCF85063 RTC, ES8311 audio, DI/DO. The CH344L RS485/RS232 ports are plain
 * USB CDC-ACM devices and work on any kernel. To be submitted to LKML
 * separately, same as the devkit DT.
 */

/dts-v1/;

#include "rk3576-recomputer-devkit.dts"

/ {
	model = "Seeed Studio reComputer Industrial RK3576";
	compatible = "seeed,recomputer-rk3576-industrial", "rockchip,rk3576";

	aliases {
		/* eMMC is the only boot medium: remap mmc0 from SD to eMMC */
		mmc0 = &sdhci;
	};

	/delete-node/ adc-keys;
};

/* The industrial carrier has no SD slot; eMMC (sdhci) is the only MMC. */
&sdmmc {
	status = "disabled";
};
