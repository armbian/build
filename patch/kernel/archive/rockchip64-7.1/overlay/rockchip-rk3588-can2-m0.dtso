/dts-v1/;
/plugin/;

#include <dt-bindings/clock/rockchip,rk3588-cru.h>

/ {
	fragment@0 {
		target = <&can2>;

		__overlay__ {
			assigned-clocks = <&cru CLK_CAN2>;
			assigned-clock-rates = <300000000>;
			status = "okay";
			pinctrl-0 = <&can2m0_pins>;
		};
	};
};
