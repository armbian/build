/dts-v1/;
/plugin/;
/ {
        fragment@0 {
                target = <&fan>;
                __overlay__ {
                        cooling-levels = <146 146 146 146 146 146 149 149 151>;
                };
        };
};

