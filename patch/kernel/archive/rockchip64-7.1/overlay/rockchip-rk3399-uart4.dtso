/dts-v1/;
/plugin/;

/ {
	compatible = "rockchip,rk3399";

	fragment@0 {
		target = <&spi1>;
		__overlay__ {
			status = "disabled";
		};
	};

	fragment@1 {
		target = <&uart4>;
		__overlay__ {
			status = "okay";
		};
	};
};
