// SPDX-License-Identifier: (GPL-2.0+ OR MIT)

/dts-v1/;

#include "meson-sm1-odroid-c4.dts"

/ {
	model = "Hardkernel ODROID-C4 - MOSI is pin y, CLK is pin x";
};

&spicc1 {
	pinctrl-0 = <&spicc1_pins &spicc1_ss0_pins>;
	pinctrl-names = "default";
	#address-cells = <1>;
	#size-cells = <0>;
	status = "okay";
	spidev@0 {
		compatible = "armbian,spi-dev";
		status = "okay";
		reg = <0>;
		spi-max-frequency = <10000000>;
	};
};

