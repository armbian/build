/dts-v1/;
/plugin/;

/ {
	compatible = "radxa,zero", "amlogic,g12a";
};

&pwm_cd {
	status = "okay";
	pinctrl-0 = <&pwm_c_x8_pins>;
	pinctrl-names = "default";
	clocks = <&xtal>;
	clock-names = "clkin2";
};
