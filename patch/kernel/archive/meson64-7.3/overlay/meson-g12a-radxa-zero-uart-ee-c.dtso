/dts-v1/;
/plugin/;

/ {
	compatible = "radxa,zero", "amlogic,g12a";

	fragment@0 {
		target = <&uart_C>;
		__overlay__ {
			status = "okay";
			pinctrl-0 = <&uart_c_pins &uart_c_cts_rts_pins>;
			pinctrl-names = "default";
		};
	};
};
