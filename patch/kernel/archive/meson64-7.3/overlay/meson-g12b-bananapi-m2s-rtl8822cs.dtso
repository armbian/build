/dts-v1/;
/plugin/;

/ {
	compatible = "bananapi,bpi-m2s", "amlogic,a311d", "amlogic,g12b";

	/* RTL8822CS SDIO WIFI */

	/* RTL8822CS BLUETOOTH */
};

&sd_emmc_a {
	status = "okay";
};

&uart_A {
	status = "okay";
};
