/dts-v1/;
/plugin/;

#include <dt-bindings/gpio/gpio.h>
#include <dt-bindings/gpio/meson-g12a-gpio.h>

/ {
	compatible = "radxa,zero", "amlogic,g12a";
};

&{/} {
	leds {
		compatible = "gpio-leds";

		led-green {
			label = "radxa-zero:green";
			gpios = <&gpio_ao GPIOAO_8 GPIO_ACTIVE_HIGH>;
			linux,default-trigger = "heartbeat";
			default-state = "on";
		};
	};
};
