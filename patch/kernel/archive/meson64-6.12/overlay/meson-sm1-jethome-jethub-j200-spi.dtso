/dts-v1/;
/plugin/;

/ {
	fragment@0 {
		target = <&sd_emmc_c>;
		__overlay__ {
			pinctrl-0 = <&emmc_ctrl_pins>, <&emmc_data_4b_pins>, <&emmc_ds_pins>;
			bus-width = <4>;
		};
	};

	fragment@1 {
		target = <&spifc>;
		__overlay__ {
			status = "okay";
		};
	};
};
