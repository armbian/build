// Definitions for w1-gpio module (without external pullup)
/dts-v1/;
/plugin/;

/ {
	compatible = "amlogic,meson-gxbb";
};

&{/} {
	w1a: onewire@0 {
		compatible = "w1-gpio";
		pinctrl-names = "default";
		gpios = <&gpio 91 6>; // GPIOY_16
		status = "okay";
	};
};

&{/} {
	w1b: onewire@1 {
		compatible = "w1-gpio";
		pinctrl-names = "default";
		gpios = <&gpio 90 6>; // GPIOY_15
		status = "okay";
	};
};
