/dts-v1/;
/plugin/;

/ {
	compatible = "rockchip,rk3328";
};

&{/aliases} {
	status = "okay";
	spi0 = "/spi@ff190000";
};

&spi0 {
	status = "okay";

	spidev {
		compatible = "armbian,spi-dev";
		status = "okay";
		reg = <0x00>;
		spi-max-frequency = <0x989680>;
	};
};
