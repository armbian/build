/dts-v1/;
/plugin/;

/ {
	metadata {
		title = "Enable PWM3-M1";
		compatible = "radxa,rock-5b";
		category = "misc";
		exclusive = "GPIO3_B2";
		description = "Enable PWM3-M1.\nOn Radxa ROCK 5B this is pin 38.";
	};

	fragment@0 {
		target = <&pwm3>;

		__overlay__ {
			status = "okay";
			pinctrl-0 = <&pwm3m1_pins>;
		};
	};
};
