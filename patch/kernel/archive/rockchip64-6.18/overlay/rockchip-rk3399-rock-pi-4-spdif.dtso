/dts-v1/;
/plugin/;

/ {
	compatible = "radxa,rockpi4", "rockchip,rk3399";

	fragment@0 {
		target = <&spdif>;
		__overlay__ {
			status = "okay";
		};
	};

	fragment@1 {
		target-path = "/sound-dit";
		__overlay__ {
			status = "okay";
		};
	};
};
