/dts-v1/;
/plugin/;

&spi0 {
	status = "okay";
	#address-cells = <1>;
	#size-cells = <0>;

	spidev: spidev@0 {
		status = "okay";
		compatible = "armbian,spi-dev";
		reg = <0>;
		/* spi default max clock 100Mhz */
		spi-max-frequency = <100000000>;
	};
};
