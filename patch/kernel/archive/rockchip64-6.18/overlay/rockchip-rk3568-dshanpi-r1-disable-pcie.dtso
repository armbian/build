// SPDX-License-Identifier: (GPL-2.0+ OR MIT)
/*
 * Disable both PCIe root complexes.
 * An unused mainline PCIe PHY draws about 0.6 W.
 * The overlay also disables any card in the E-key slot.
 */

/dts-v1/;
/plugin/;

/ {
	metadata {
		title = "Disable PCIe to save idle power (DshanPi R1/R1+)";
		compatible = "100ask,dshanpi-r1", "rockchip,rk3568";
		category = "misc";
		description = "Disable pcie2x1 and pcie3x2. The PHYs then power off. Both M.2 slots stop working.";
	};

	fragment@0 {
		target = <&pcie2x1>;
		__overlay__ {
			status = "disabled";
		};
	};

	fragment@1 {
		target = <&pcie3x2>;
		__overlay__ {
			status = "disabled";
		};
	};
};
