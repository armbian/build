/dts-v1/;
/plugin/;

/ {
	metadata {
		title = "Enable USB-C PD";
		compatible = "radxa,rock-5b", "radxa,rock-5b-plus", "radxa,rock-5t";
		description = "Enable power-delivery messages over USB-C.\nThis may cause boot looping.\nIf this overlay is not enabled, USB PD negotiation will not be tried.\nYou are advised to have a recovery strategy in place before enabling this overlay.";
	};

	fragment@0 {
		target = <&usbc0>;
		__overlay__ {
			status = "okay";
		};
	};
};
