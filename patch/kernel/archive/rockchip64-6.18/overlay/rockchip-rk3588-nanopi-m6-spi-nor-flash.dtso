/dts-v1/;
/plugin/;

&sdhci {
	status = "disabled";
};

&sfc {
	pinctrl-names = "default";
	pinctrl-0 = <&fspim0_pins>;
	status = "okay";

	flash@0 {
		compatible = "jedec,spi-nor";
		reg = <0x0>;
		spi-max-frequency = <50000000>;
		spi-rx-bus-width = <4>;
		spi-tx-bus-width = <1>;
	};
};
