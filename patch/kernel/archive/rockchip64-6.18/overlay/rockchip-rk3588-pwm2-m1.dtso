/dts-v1/;
/plugin/;

/ {
	metadata {
		title = "Enable PWM2-M1";
		compatible = "radxa,rock-5b";
		category = "misc";
		exclusive = "GPIO3_B1";
		description = "Enable PWM2-M1.\nOn Radxa ROCK 5B this is pin 36.";
	};

	fragment@0 {
		target = <&pwm2>;

		__overlay__ {
			status = "okay";
			pinctrl-0 = <&pwm2m1_pins>;
		};
	};
};
