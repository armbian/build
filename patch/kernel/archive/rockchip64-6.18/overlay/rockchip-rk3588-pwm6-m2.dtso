/dts-v1/;
/plugin/;

/ {
	metadata {
		title = "Enable PWM6-M2";
		compatible = "radxa,rock-5b";
		category = "misc";
		exclusive = "GPIO4_C5";
		description = "Enable PWM6-M2.\nOn Radxa ROCK 5B this is pin 28.";
	};
};

&pwm6 {
	status = "okay";
	pinctrl-0 = <&pwm6m2_pins>;
};
