// SPDX-License-Identifier: (GPL-2.0+ OR MIT)

/* Compatibility/control DTB: identical reference wiring, explicit BB CM4 identity. */

/dts-v1/;

#include "rk3566-eltay-rm66.dtsi"
#include "rk3566-eltay-rm66-reference-carrier.dtsi"

/ {
	model = "ELTAY RM66 on ELTAY BB CM4";
	compatible = "elron,eltay-rm66-bb-cm4", "elron,eltay-rm66", "rockchip,rk3566";
};
