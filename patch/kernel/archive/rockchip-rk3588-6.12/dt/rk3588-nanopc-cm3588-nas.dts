// SPDX-License-Identifier: (GPL-2.0+ OR MIT)

/dts-v1/;

#include "rk3588-friendlyelec-cm3588-nas.dts"

// DO NOT ADD ANYTHING TO THIS DTS!
// This file only exists for temporary backwards compatibility for existing installations installed before 2024-10-20.
// THIS COMPATIBILITY PATCH WILL BE DELETED in kernel 6.14, please migrate to the new dts by editing your "/boot/armbianEnv.txt"!
