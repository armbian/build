/dts-v1/;
/plugin/;

/ {

	fragment@0 {
		target-path = "/opp_table0/opp-1200000000";
		__overlay__ {

			status = "okay";

		};
	};

	fragment@1 {
		target-path = "/opp_table0/opp-1296000000";
		__overlay__ {

			status = "okay";

		};
	};

};
