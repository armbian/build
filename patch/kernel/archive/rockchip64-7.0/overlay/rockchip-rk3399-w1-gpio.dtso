// Definitions for w1-gpio module (without external pullup)
/dts-v1/;
/plugin/;

/ {
	compatible = "rockchip,rk3399";

	fragment@0 {
		target-path = "/";
		__overlay__ {

			w1: onewire@0 {
				compatible = "w1-gpio";
				pinctrl-names = "default";
				gpios = <&gpio1 4 0 0xae>; // GPIO1_A4
				status = "okay";
			};
		};
	};
};
