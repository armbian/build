/dts-v1/;

/ {
    compatible = "rockchip,rk3328";
    fragment@0 {
        target-path = "/opp-table-0";
        __overlay__ {
		opp-1392000000 {
			opp-hz = /bits/ 64 <1392000000>;
			opp-microvolt = <1400000>;
			clock-latency-ns = <40000>;
		};
        };
    };
};
