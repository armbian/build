// SPDX-License-Identifier: (GPL-2.0+ OR MIT)
/*
 * Copyright (c) 2025 Ian Goodacre
 */

/dts-v1/;
#include "rk3328-nanopi-r2s-plus.dts"

/delete-node/ &rtl8211e;

&gmac2io {
	phy-handle = <&rtl8211f>;
	snps,reset-delays-us = <0 15000 50000>;
	tx_delay = <0x22>;
	rx_delay = <0x12>;

	mdio {
		rtl8211f: ethernet-phy@1 {
			compatible = "ethernet-phy-ieee802.3-c22";
			reg = <0x1>;
			realtek,led-data = <0xae00>;
		};
	};
};
