/dts-v1/;
/plugin/;

/ {
	metadata {
		title = "Enable PWM15-M0";
		compatible = "radxa,rock-5b";
		category = "misc";
		exclusive = "GPIO3_C3";
		description = "Enable PWM15-M0.\nOn Radxa ROCK 5B this is pin 7.";
	};

	fragment@0 {
		target = <&pwm15>;

		__overlay__ {
			status = "okay";
			pinctrl-0 = <&pwm15m0_pins>;
		};
	};
};
