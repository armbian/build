#include "rk356x-u-boot.dtsi"

/* Gadget mode for Rockusb loader / UMS / etc */
&usb_host0_xhci {
	dr_mode = "peripheral";
	extcon = <&usb2phy0>;
	maximum-speed = "high-speed";
	phys = <&usb2phy0_otg>;
	phy-names = "usb2-phy";
	status = "okay";
};

&usb2phy0 {
	status = "okay";
};

&usb2phy0_otg {
	status = "okay";
};
