// SPDX-License-Identifier: GPL-2.0+

#include "rk3399-u-boot.dtsi"

&vcc5v0_host {
	regulator-always-on;
};

&vdd_center {
	regulator-min-microvolt = <950000>;
	regulator-max-microvolt = <950000>;
};

&vdd_log {
	regulator-init-microvolt = <950000>;
};

/*
 * The vendor clock-freq-min-max property overrides max-frequency. In high
 * speed (50 MHz) SPL reads fail with data CRC errors: stay at default speed.
 */
&sdmmc {
	/delete-property/ clock-freq-min-max;
	max-frequency = <25000000>;
};
