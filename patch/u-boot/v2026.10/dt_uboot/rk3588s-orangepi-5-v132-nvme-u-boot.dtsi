// SPDX-License-Identifier: (GPL-2.0+ OR MIT)

#include "rk3588s-u-boot.dtsi"
#include "rk3588s-orangepi-5-u-boot.dtsi"

&binman {
	simple-bin-spi {
		filename = "u-boot-rockchip-spi-v132.bin";
	};
};
