// SPDX-License-Identifier: GPL-2.0+

#include "rk3399-nanopi4-u-boot.dtsi"

/* Logic and center rail voltages as in the FriendlyElec M4V2 BSP. */
&vdd_center {
	regulator-init-microvolt = <930000>;
};

&vdd_log {
	regulator-init-microvolt = <950000>;
};
