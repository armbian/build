// SPDX-License-Identifier: GPL-2.0+

#include "rk3399-u-boot.dtsi"

&gpio0 {
	bootph-pre-ram;
};

&sdmmc_pwr {
	bootph-pre-ram;
};

&vcc3v0_sd {
	bootph-pre-ram;
};

&vdd_log {
	regulator-init-microvolt = <950000>;
};
