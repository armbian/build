// SPDX-License-Identifier: (GPL-2.0+ OR MIT)

#include "rk3576-u-boot.dtsi"

&sdhci {
	cap-mmc-highspeed;
};

/*
 * The Linux DTS runs the USB-C port as OTG behind the FUSB302. U-Boot has
 * no role switch for it, so use host mode to boot from USB-C storage.
 */
&usb_drd0_dwc3 {
	dr_mode = "host";
};

/*
 * U-Boot has no TCPM, so let the USB2 PHY switch on the USB-C VBUS.
 * Linux leaves it to the FUSB302.
 */
&u2phy0_otg {
	phy-supply = <&vcc_5v0_typec0>;
};
