// SPDX-License-Identifier: (GPL-2.0+ OR MIT)
/*
 * Seeed Studio reComputer Industrial RK3576 (SoM + carrier) — mainline U-Boot DT.
 *
 * Difference-only overlay on top of the reComputer RK3576 Dev Kit DT: both
 * boards share the same RK3576 SoM (eMMC, RK806 PMIC, RTL8211F on GMAC0,
 * USB, PCIe, HDMI). Carrier differences applied here:
 *   - no SD slot: eMMC (sdhci) is the only boot medium, mmc0 alias remapped
 *   - no volume-up adc key circuit on the carrier (avoid floating SARADC
 *     triggering the key) — node removed
 *   - GMAC1 PHY on the carrier is a Maxio MAE0621A (no mainline driver);
 *     left enabled, networking on GMAC1 simply won't come up in U-Boot
 */

/dts-v1/;

#include "rk3576-recomputer-devkit.dts"

/ {
	model = "Seeed Studio reComputer Industrial RK3576";
	compatible = "seeed,recomputer-rk3576-industrial", "rockchip,rk3576";

	aliases {
		/* eMMC is the only boot medium: remap mmc0 from SD to eMMC */
		mmc0 = &sdhci;
	};

	/delete-node/ adc-keys;
};

/* The industrial carrier has no SD slot; eMMC (sdhci) is the only MMC. */
&sdmmc {
	status = "disabled";
};
