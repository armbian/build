// SPDX-License-Identifier: (GPL-2.0+ OR MIT)

/dts-v1/;

#include "rk3588s-nanopi-m6.dts"

/ {
	model = "FriendlyElec NanoPi M6 (SPI)";
	compatible = "friendlyelec,nanopi-m6", "rockchip,rk3588s";
};

&sdhci {
	status = "disabled";
};

&sfc {
	pinctrl-names = "default";
	pinctrl-0 = <&fspim0_pins>;
	status = "okay";

	flash@0 {
		compatible = "jedec,spi-nor";
		reg = <0x0>;
		spi-max-frequency = <50000000>;
		spi-rx-bus-width = <4>;
		spi-tx-bus-width = <1>;
	};
};
