// SPDX-License-Identifier: (GPL-2.0+ OR MIT)

/dts-v1/;

#include "rk3588s-nanopi-m6.dts"

/ {
	model = "FriendlyElec NanoPi M6 (Generic)";
	compatible = "friendlyelec,nanopi-m6", "rockchip,rk3588s";
};

/* M6 eMMC and FSPI-M0 share pins; SPL enables exactly one before DM. */
&sdhci {
	status = "disabled";
};

&sfc {
	pinctrl-names = "default";
	pinctrl-0 = <&fspim0_pins>;
	status = "disabled";

	flash@0 {
		compatible = "jedec,spi-nor";
		reg = <0>;
		spi-max-frequency = <50000000>;
		spi-rx-bus-width = <4>;
		spi-tx-bus-width = <1>;
	};
};
