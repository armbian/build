// SPDX-License-Identifier: (GPL-2.0+ OR MIT)
/*
 * U-Boot DTSI overlay for Magicsee C400 Plus
 * Copyright (c) 2026 jomadeto
 */

#include "meson-gxl-u-boot.dtsi"

/ {
	chosen {
		stdout-path = "serial0:115200n8";
		stdout-control = "vidconsole", "serial0";
		bootargs = "console=ttyAML0,115200n8 console=tty0";
	};
};

&sd_emmc_c {
	status = "okay";
	pinctrl-0 = <&emmc_pins>;
	pinctrl-names = "default";

	vmmc-supply = <&vcc_3v3>;
	vqmmc-supply = <&vcc_3v3>;
	
	bus-width = <8>;
	cap-mmc-highspeed;
	max-frequency = <50000000>;
	non-removable;
	disable-wp;

	cap-mmc-hw-reset;
	
	/delete-property/ mmc-hs200-1_8v;
	/delete-property/ mmc-hs400-1_8v;
};
