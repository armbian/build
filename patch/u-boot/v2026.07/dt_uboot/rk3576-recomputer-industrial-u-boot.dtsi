// SPDX-License-Identifier: (GPL-2.0+ OR MIT)
/*
 * Seeed Studio reComputer Industrial RK3576 — U-Boot DT additions.
 * Same SoM as the devkit; this carrier boots from eMMC only (no SPI NOR,
 * so no SFC bootph propagation needed — just make sure sdhci is probed
 * in SPL for the boot device scan).
 */

#include "rk3576-u-boot.dtsi"

&sdhci {
	bootph-pre-ram;
	bootph-some-ram;
};
