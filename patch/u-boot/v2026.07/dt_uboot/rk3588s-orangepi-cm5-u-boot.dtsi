// SPDX-License-Identifier: (GPL-2.0+ OR MIT)

// support for u-boot booting from image on a diffrenet media is limited. such action is rearly needed and is not recomended. check https://github.com/armbian/build/pull/10916 for more info.
#include "rk3588s-u-boot.dtsi"

/ {
	chosen {
		u-boot,spl-boot-order = &sdmmc, &sdhci;
	};
};

&sdhci {
	bootph-pre-ram;
	bootph-some-ram;
	status = "okay";
};

&sdmmc {
	bootph-pre-ram;
	bootph-some-ram;
	status = "okay";
};
