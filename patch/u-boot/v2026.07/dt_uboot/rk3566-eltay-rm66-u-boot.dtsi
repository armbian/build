// SPDX-License-Identifier: (GPL-2.0+ OR MIT)

#include "rk356x-u-boot.dtsi"

/ {
	chosen {
		u-boot,spl-boot-order = "same-as-spl", &sdmmc0, &sdhci;
	};
};

&sfc {
	u-boot,spl-sfc-no-dma;

	flash@0 {
		bootph-pre-ram;
		bootph-some-ram;
	};
};
