// SPDX-License-Identifier: GPL-2.0+
/*
 * Copyright (c) 2026 sckiyo <sckiyo@outlook.com>
 */

#include "rk356x-u-boot.dtsi"

&sdhci {
	cap-mmc-highspeed;
	mmc-hs400-1_8v;
	mmc-hs400-enhanced-strobe;
};

/* The vendor kernel powers pd_npu before the RK809 driver probes. */
&vdd_npu {
	regulator-always-on;
	regulator-boot-on;
	regulator-init-microvolt = <900000>;
};
