// SPDX-License-Identifier: (GPL-2.0+ OR MIT)
//
// Orange Pi 5 PCB revisions v1.2.3 and v1.3.x wire the M.2 power switch to
// GPIO2_A1 instead of GPIO0_C5, so PCIe/NVMe stays dead with the stock DTB
// (LTSSM 0x3). Details:
// https://forum.armbian.com/topic/61753-orangepi-5-nvme-pcie-voltage-regulator-gpio-bug/

/dts-v1/;

#include "rk3588s-orangepi-5.dtsi"
#include <dt-bindings/gpio/gpio.h>
#include <dt-bindings/pinctrl/rockchip.h>

/ {
	model = "Xunlong Orange Pi 5 (NVMe PCB v1.2.3)";
	compatible = "xunlong,orangepi-5", "rockchip,rk3588s";

	vcc3v3_pcie20: regulator-vcc3v3-pcie20 {
		compatible = "regulator-fixed";
		enable-active-high;
		gpios = <&gpio2 RK_PA1 GPIO_ACTIVE_HIGH>;
		regulator-name = "vcc3v3_pcie20";
		regulator-boot-on;
		regulator-min-microvolt = <3300000>;
		regulator-max-microvolt = <3300000>;
		startup-delay-us = <50000>;
		vin-supply = <&vcc5v0_sys>;
	};
};

&pcie2x1l2 {
	reset-gpios = <&gpio3 RK_PD1 GPIO_ACTIVE_HIGH>;
	vpcie3v3-supply = <&vcc3v3_pcie20>;
	status = "okay";
};

&sfc {
	status = "okay";
};
