// SPDX-License-Identifier: (GPL-2.0+ OR MIT)

#include "rk3576-u-boot.dtsi"

&sfc0 {
	flash@0 {
		bootph-pre-ram;
		bootph-some-ram;
	};
};

&ufshc {
	vcc-supply = <&vcc_3v3_ufs_s0>;
	vccq-supply = <&vcc_1v2_ufs_vccq_s0>;
	vccq2-supply = <&vcc_1v8_ufs_vccq2_s0>;
};
