// SPDX-License-Identifier: (GPL-2.0-only OR MIT)

/*
 * The board has no eMMC. Its empty slot shares supplies (vemc_1, vufs) with
 * UFS; probing it power-cycles those regulators and breaks UFS.
 */
&mmc0 {
	status = "disabled";
};

/*
 * U-Boot has no USB role switch or Type-C controller support: use USB-C as
 * a gadget (eg. UMS), with VBUS forced.
 */
&ssusb0 {
	dr_mode = "peripheral";
	mediatek,force-vbus;
};

/* No ports are wired to ssusb2; the USB-A ports are on a PCIe xHCI (VL805) */
&ssusb2 {
	status = "disabled";
};

