// SPDX-License-Identifier: (GPL-2.0+ OR MIT)
/*
 * Copyright (c) 2021 Rockchip Electronics Co., Ltd
 *
 */

/dts-v1/;
#include "rk3588s-orangepi-5.dts"

/ {
	model = "Orange Pi 5B";
	compatible = "rockchip,rk3588s-orangepi-5b", "rockchip,rk3588";

	/delete-node/ vcc3v3_pcie2x1l2;
};

&sfc {
	u-boot,dm-spl;
	status = "disabled";
};

&pcie2x1l2 {
	u-boot,dm-pre-reloc;
	status = "disabled";
};
