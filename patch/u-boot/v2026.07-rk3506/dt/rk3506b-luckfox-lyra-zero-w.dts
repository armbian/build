// SPDX-License-Identifier: (GPL-2.0+ OR MIT)

/dts-v1/;
#include "rk3506b-luckfox-lyra.dtsi"

/ {
	model = "Luckfox Lyra Zero W";
	compatible = "luckfox,lyra-zero-w", "rockchip,rk3506";
};

&fspi {
	status = "okay";

	flash@0 {
		compatible = "spi-nand";
		reg = <0>;
		bootph-pre-ram;
		bootph-some-ram;
		spi-max-frequency = <80000000>;
		spi-rx-bus-width = <4>;
		spi-tx-bus-width = <1>;
		vcc-supply = <&vcc_3v3>;
	};
};
