## patch/u-boot/u-boot-sophgo-sg200x/cvitek-board-files/arm64/configs/cvitek_sg2000_milkv_duos_glibc_arm64_emmc_defconfig
```kconfig
CONFIG_ARM=y
CONFIG_SYS_MALLOC_F_LEN=0x2000
CONFIG_NR_DRAM_BANKS=1
CONFIG_DM_GPIO=y
CONFIG_DEFAULT_DEVICE_TREE="cv181x_asic"
CONFIG_IDENT_STRING=" cvitek_cv181x"
CONFIG_ARMV8_SET_SMPEN=y
CONFIG_TARGET_CVITEK_CV181X=y
CONFIG_DISTRO_DEFAULTS=y
CONFIG_FIT=y
# CONFIG_ARCH_FIXUP_FDT_MEMORY is not set
CONFIG_BOOTDELAY=1
# CONFIG_DISPLAY_CPUINFO is not set
# CONFIG_DISPLAY_BOARDINFO is not set
CONFIG_SYS_PROMPT="soph# "
# CONFIG_CMD_CONSOLE is not set
# CONFIG_CMD_XIMG is not set
# CONFIG_CMD_EDITENV is not set
# CONFIG_CMD_CRC32 is not set
# CONFIG_CMD_LZMADEC is not set
# CONFIG_CMD_UNLZ4 is not set
# CONFIG_CMD_UNZIP is not set
CONFIG_CMD_GPIO=y
# CONFIG_CMD_LOADS is not set
CONFIG_CMD_MMC=y
# CONFIG_CMD_ITEST is not set
CONFIG_CMD_CACHE=y
CONFIG_CMD_CVI_VO=y
# CONFIG_ISO_PARTITION is not set
# CONFIG_EFI_PARTITION is not set
CONFIG_OF_CONTROL=y
CONFIG_NET_RANDOM_ETHADDR=y
CONFIG_DM=y
CONFIG_DWAPB_GPIO=y
CONFIG_MMC_SDHCI=y
CONFIG_MMC_SDHCI_SDMA=y
CONFIG_MMC_SDHCI_CVITEK=y
CONFIG_MTD=y
CONFIG_PHY_CVITEK=y
CONFIG_DM_ETH=y
CONFIG_ETH_DESIGNWARE=y
CONFIG_SYS_NS16550=y
CONFIG_SPI=y
CONFIG_DM_VIDEO=y
CONFIG_BMP_16BPP=y
CONFIG_BMP_24BPP=y
CONFIG_BMP_32BPP=y
CONFIG_LZ4=y
CONFIG_LZMA=y
# CONFIG_TOOLS_LIBCRYPTO is not set
CONFIG_OF_LIBFDT_OVERLAY=y
```

## patch/u-boot/v2026.07/board_eltay-rm66/board/Kconfig
```kconfig
if TARGET_ELTAY_RM66_RK3566

config SYS_BOARD
	default "eltay-rm66-rk3566"

config SYS_VENDOR
	default "elron"

config SYS_CONFIG_NAME
	default "evb_rk3568"

endif
```

## patch/u-boot/v2027.01/defconfig/mt8395_radxa_nio_12l_defconfig
```kconfig
#include <configs/mt8195.config>

CONFIG_DEFAULT_DEVICE_TREE="mediatek/mt8395-radxa-nio-12l"
CONFIG_DEFAULT_FDT_FILE="mediatek/mt8395-radxa-nio-12l.dtb"
CONFIG_SYS_LOAD_ADDR=0x44000000
CONFIG_LEGACY_IMAGE_FORMAT=y
CONFIG_CMD_BIND=y
CONFIG_CMD_BOOTZ=y
CONFIG_CMD_ITEST=y
CONFIG_CMD_MEMINFO=y
CONFIG_CMD_SETEXPR=y
CONFIG_CMD_USB=y
CONFIG_CMD_USB_MASS_STORAGE=y
CONFIG_ENV_IS_IN_SCSI=y
CONFIG_ENV_SIZE=0x2000
CONFIG_ENV_SCSI_HW_PARTITION="1:0"
CONFIG_PHY_MTK_TPHY=y
CONFIG_PHY_REALTEK=y
CONFIG_DWC_ETH_QOS=y
CONFIG_DWC_ETH_QOS_MTK=y
CONFIG_DM_REGULATOR_FIXED=y
CONFIG_USB=y
CONFIG_USB_XHCI_HCD=y
CONFIG_USB_XHCI_MTK=y
CONFIG_USB_MTU3=y
CONFIG_USB_MTU3_GADGET=y
CONFIG_USB_KEYBOARD=y
CONFIG_USB_STORAGE=y
CONFIG_USB_GADGET=y
CONFIG_DM_USB_GADGET=y
CONFIG_USB_GADGET_DOWNLOAD=y
CONFIG_USB_GADGET_VENDOR_NUM=0x0e8d
CONFIG_USB_GADGET_PRODUCT_NUM=0x201c
CONFIG_BZIP2=y
```
