/dts-v1/;
/plugin/;

/*
 * Diagnostic overlay for OPi3B DSI artifact testing.
 *
 * Force VP0 to use Cluster0 as the primary plane instead of Smart0. The vendor
 * RK356x VOP2 driver rejects incomplete plane masks and falls back to its
 * default assignment, so keep all six RK3566 windows assigned to VP0 and only
 * change the primary plane to Cluster0.
 *
 * Numeric IDs come from include/dt-bindings/display/rockchip_vop.h:
 *   ROCKCHIP_VOP2_CLUSTER0 = 0
 *   ROCKCHIP_VOP2_ESMART0  = 2
 *   ROCKCHIP_VOP2_SMART0   = 4
 */

/ {
	compatible = "rockchip,rk3566";

	fragment@0 {
		target = <&vp0>;
		__overlay__ {
			rockchip,plane-mask = <0x3f>;
			rockchip,primary-plane = <0>;
		};
	};
};
